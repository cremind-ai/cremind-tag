## CMakeLists.txt
```
# The bridge's maintenance-port core behind a native_sim pseudo-terminal, for
# driving it with the host's real client (interop.py, Cremind's hardware runtime).
cmake_minimum_required(VERSION 3.20.0)
find_package(Zephyr REQUIRED HINTS $ENV{ZEPHYR_BASE})
project(ctag_bridge_maint_pty)

set(bridge ${CMAKE_CURRENT_SOURCE_DIR}/../..)
target_sources(app PRIVATE
  ${bridge}/src/core/bflash.c
  ${bridge}/src/core/fontstore.c
  ${bridge}/src/core/maint.c
  src/main.c)
target_include_directories(app PRIVATE ${bridge}/src/core)
```

## prj.conf
```kconfig
CONFIG_FLASH=y
CONFIG_SERIAL=y
CONFIG_CTAG_FRAME=y
CONFIG_CTAG_CBOR=y
CONFIG_CTAG_RENDER=y
CONFIG_CTAG_SESSION=y
CONFIG_PSA_CRYPTO=y
CONFIG_PSA_CRYPTO_PROVIDER_MBEDTLS=y
CONFIG_PSA_WANT_ALG_HMAC=y
CONFIG_PSA_WANT_ALG_SHA_256=y
CONFIG_PSA_WANT_ALG_CCM=y
CONFIG_PSA_WANT_KEY_TYPE_AES=y
CONFIG_PSA_WANT_KEY_TYPE_HMAC=y
CONFIG_ENTROPY_GENERATOR=y
# uart0 is the maintenance port (a pseudo-terminal); printk goes to stdout.
CONFIG_UART_CONSOLE=n
# The nRF52840 DK geometry: 8 MiB part, 1 MiB working space.
CONFIG_CTAG_BRIDGE_WORKING_SPACE=1048576
CONFIG_MAIN_STACK_SIZE=8192
```

## boards/native_sim.overlay
```dts
/* An 8 MiB external NOR stand-in (the nRF52840 DK's MX25R64) and the
 * maintenance port on uart0 (a pseudo-terminal). */
/ {
	chosen {
		cremind,bridge-flash = &ext_flash_ctrl;
		cremind,bridge-maint = &uart0;
	};

	ext_flash_ctrl: flash-controller@40000000 {
		compatible = "zephyr,sim-flash";
		reg = <0x40000000 DT_SIZE_M(8)>;
		#address-cells = <1>;
		#size-cells = <1>;
		erase-value = <0xff>;

		ext_flash: flash@0 {
			status = "okay";
			compatible = "soc-nv-flash";
			erase-block-size = <4096>;
			write-block-size = <4>;
			reg = <0x00000000 DT_SIZE_M(8)>;
		};
	};
};
```

## src/main.c
```c
/*
 * The bridge's maintenance-port core (src/core/maint.c, fontstore.c,
 * bflash.c) on native_sim: uart0 is a pseudo-terminal, the external flash a
 * simulated 8 MiB NOR. interop.py drives it with the companion's client.
 */
#include <zephyr/drivers/uart.h>
#include <zephyr/kernel.h>
#include <zephyr/sys/printk.h>

#include <ctag/ctag_crypto.h>

#include "bflash.h"
#include "fontstore.h"
#include "maint.h"

static const struct device *const uart = DEVICE_DT_GET(DT_CHOSEN(cremind_bridge_maint));
static struct bflash flash;
static struct fontstore fonts;
static struct maint mt;
static ctag_sha256_ctx sha_ctx;

static int sha_init(void *ctx)
{
	return ctag_crypto_sha256_init(ctx);
}

static int sha_update(void *ctx, const uint8_t *data, size_t len)
{
	return ctag_crypto_sha256_update(ctx, data, len);
}

static int sha_finish(void *ctx, uint8_t digest[32])
{
	return ctag_crypto_sha256_finish(ctx, digest);
}

static const struct ctag_sha256_ops sha = {sha_init, sha_update, sha_finish, &sha_ctx};

static void io_write(void *ctx, const uint8_t *data, size_t len)
{
	ARG_UNUSED(ctx);
	for (size_t i = 0; i < len; i++) {
		uart_poll_out(uart, data[i]);
	}
}

static void io_reboot(void *ctx)
{
	ARG_UNUSED(ctx);
	printk("maint_pty: REBOOT requested\n");
}

static size_t io_counters(void *ctx, struct ctag_cbor_counter *items, size_t max)
{
	const struct ctag_cbor_counter c = CTAG_CBOR_COUNTER("sessions_ok", 0);

	ARG_UNUSED(ctx);
	if (max == 0) {
		return 0;
	}
	items[0] = c;
	return 1;
}

static const struct maint_io io = {.write = io_write, .reboot = io_reboot, .counters = io_counters};

int main(void)
{
	int err;

	(void)ctag_crypto_init();
	err = bflash_init(&flash, DEVICE_DT_GET(DT_CHOSEN(cremind_bridge_flash)),
			  CONFIG_CTAG_BRIDGE_WORKING_SPACE);
	fontstore_init(&fonts, &flash, err == 0);
	maint_init(&mt, &io, NULL, &fonts, &sha, 0xB0070001u, "0.1.0", "native_sim",
		   CTAG_BOARD_NRF52840_BRIDGE);
	printk("maint_pty: ready (flash %u B, slots of %u B)\n", flash.geom.flash_size,
	       flash.geom.slot_size);
	for (;;) {
		unsigned char c;
		bool any = false;

		while (uart_poll_in(uart, &c) == 0) {
			maint_rx(&mt, &c, 1u);
			any = true;
		}
		if (!any) {
			k_sleep(K_MSEC(1));
		}
	}
	return 0;
}
```
