## CMakeLists.txt
```
# Bridge core logic on native_sim (docs/bridge-firmware.md "Tests"): the same
# sources as apps/bridge/src/core, the flash simulator standing in for the
# external NOR, mocked Bluetooth for the scheduler (lib/sched, linked through
# CONFIG_CTAG_SCHED), and a fake tag built from the tag-side libraries for the
# session.
cmake_minimum_required(VERSION 3.20.0)
find_package(Zephyr REQUIRED HINTS $ENV{ZEPHYR_BASE})
project(ctag_bridge_core_test)

set(bridge ${CMAKE_CURRENT_SOURCE_DIR}/../..)
set(host ${bridge}/../../tests/host)
include(${host}/vectors.cmake)

target_sources(app PRIVATE
  ${bridge}/src/core/bflash.c
  ${bridge}/src/core/fontstore.c
  ${bridge}/src/core/delivery.c
  ${bridge}/src/core/tagsess.c
  ${bridge}/src/core/maint.c
  src/common.c
  src/test_bflash.c
  src/test_fontstore.c
  src/test_delivery.c
  src/test_sched.c
  src/test_session.c
  src/test_maint.c
  src/test_golden.c)
target_include_directories(app PRIVATE ${bridge}/src/core src)
ctag_test_vectors(app ${PYTHON_EXECUTABLE})
```

## Kconfig
```
rsource "../../Kconfig.bridge"

source "Kconfig.zephyr"
```

## prj.conf
```kconfig
CONFIG_ZTEST=y
CONFIG_ZTEST_STACK_SIZE=16384

# External NOR stand-in (boards/native_sim*.overlay: 32 MiB, 4-byte writes,
# fault injection for the power-cut tests).
CONFIG_FLASH=y
CONFIG_FLASH_SIMULATOR_CALLBACKS=y

# The libraries the bridge links (and the tag-side ones the fake tag uses).
CONFIG_CTAG_FRAME=y
CONFIG_CTAG_CBOR=y
CONFIG_CTAG_RENDER=y
CONFIG_CTAG_FRAG=y
CONFIG_CTAG_SESSION=y
CONFIG_CTAG_TXN=y
CONFIG_CTAG_SCHED=y

# PSA through Mbed TLS on the host (as tests/ztest/session).
CONFIG_PSA_CRYPTO=y
CONFIG_PSA_CRYPTO_PROVIDER_MBEDTLS=y
CONFIG_PSA_WANT_ALG_HMAC=y
CONFIG_PSA_WANT_ALG_SHA_256=y
CONFIG_PSA_WANT_ALG_CCM=y
CONFIG_PSA_WANT_KEY_TYPE_AES=y
CONFIG_PSA_WANT_KEY_TYPE_HMAC=y
CONFIG_ENTROPY_GENERATOR=y

# The development geometry of the nRF52840 DK is exercised as well; the
# default working space (16 MiB) on the 32 MiB simulated part puts the
# directory and the pending ring above the 16 MiB boundary.
CONFIG_CTAG_BRIDGE_WORKING_SPACE=16777216
CONFIG_CTAG_BRIDGE_MAINT_TX_FRAME=1536

# The nRF52840's two tag sessions at once (socs/nrf52840.conf; the nRF52832
# configuration of testcase.yaml has one).
CONFIG_CTAG_BRIDGE_SESSIONS=2
```

## boards/native_sim_native_64.overlay
```dts
/*
 * A 32 MiB external NOR stand-in: 4 KiB erase sectors, 4-byte program units
 * (as the nRF QSPI NOR driver requires), so the > 16 MiB address map of large
 * parts is exercised.
 */
/ {
	chosen {
		cremind,bridge-flash = &ext_flash_ctrl;
	};

	ext_flash_ctrl: flash-controller@40000000 {
		compatible = "zephyr,sim-flash";
		reg = <0x40000000 DT_SIZE_M(32)>;
		#address-cells = <1>;
		#size-cells = <1>;
		erase-value = <0xff>;

		ext_flash: flash@0 {
			status = "okay";
			compatible = "soc-nv-flash";
			erase-block-size = <4096>;
			write-block-size = <4>;
			reg = <0x00000000 DT_SIZE_M(32)>;
		};
	};
};
```

## src/common.c
```c
/* Shared fixtures of the bridge core tests. */
#include <string.h>

#include <zephyr/drivers/flash.h>
#include <zephyr/drivers/flash/flash_simulator.h>
#include <zephyr/sys/util.h>

#include "common.h"
#include "v_fontpack.h"
#include "v_layouts.h"

struct bridge_env benv;
uint8_t scratch[CTAG_LAYOUT_HARD_MAX] __aligned(4);

const uint8_t *fixture_pack = V_FONTPACK_DATA;
size_t fixture_pack_len = V_FONTPACK_LEN;
const uint8_t *fixture_pack_id = V_FONTPACK_PACK_ID;
const uint8_t *small_layout;
size_t small_layout_len;

/* ---- SHA-256 over PSA ---- */

static ctag_sha256_ctx sha_ctx;

static int sha_init(void *ctx)
{
	return ctag_crypto_sha256_init(ctx);
}

static int sha_update(void *ctx, const uint8_t *data, size_t len)
{
	return ctag_crypto_sha256_update(ctx, data, len);
}

static int sha_finish(void *ctx, uint8_t digest[32])
{
	return ctag_crypto_sha256_finish(ctx, digest);
}

const struct ctag_sha256_ops test_sha = {sha_init, sha_update, sha_finish, &sha_ctx};

void sha256(const void *data, size_t len, uint8_t out[32])
{
	ctag_sha256_ctx c;

	zassert_ok(ctag_crypto_sha256_init(&c));
	zassert_ok(ctag_crypto_sha256_update(&c, data, len));
	zassert_ok(ctag_crypto_sha256_finish(&c, out));
}

/* ---- Flash ---- */

static int32_t cut = -1;

static int cut_write(const struct device *dev, off_t offset, uint8_t data)
{
	ARG_UNUSED(dev);
	ARG_UNUSED(offset);
	if (cut == 0) {
		return -EIO;
	}
	if (cut > 0) {
		cut--;
	}
	return data;
}

static int cut_erase(const struct device *dev, off_t unit)
{
	size_t size;
	uint8_t *mem = flash_simulator_get_memory(dev, &size);

	if (cut == 0) {
		return -EIO; /* power lost before the erase */
	}
	memset(mem + unit, 0xFF, 4096u);
	return 0;
}

static const struct flash_simulator_cb cut_cb = {.write_byte = cut_write, .erase_unit = cut_erase};

void flash_cut_after(int32_t bytes)
{
	cut = bytes;
}

uint8_t *flash_mem(void)
{
	size_t size;

	return flash_simulator_get_memory(EXT_FLASH_DEV, &size);
}

void flash_wipe(void)
{
	size_t size;
	uint8_t *mem = flash_simulator_get_memory(EXT_FLASH_DEV, &size);

	memset(mem, 0xFF, size);
	flash_simulator_set_callbacks(EXT_FLASH_DEV, &cut_cb);
	cut = -1;
}

/* ---- Persistence fake ---- */

struct kv {
	bool used;
	char name[8];
	uint8_t data[64];
	size_t len;
};

static struct kv kv[96];
void (*save_probe)(const char *name);

void kv_clear(void)
{
	memset(kv, 0, sizeof(kv));
}

int kv_save(void *ctx, const char *name, const void *data, size_t len)
{
	struct kv *free_slot = NULL;
	size_t i;

	ARG_UNUSED(ctx);
	if (save_probe != NULL) {
		save_probe(name);
	}
	zassert_true(len <= sizeof(kv[0].data), "record %s too long (%zu)", name, len);
	for (i = 0; i < ARRAY_SIZE(kv); i++) {
		if (kv[i].used && strcmp(kv[i].name, name) == 0) {
			free_slot = &kv[i];
			break;
		}
		if (!kv[i].used && free_slot == NULL) {
			free_slot = &kv[i];
		}
	}
	zassert_not_null(free_slot);
	if (len == 0u) {
		free_slot->used = false;
		return 0;
	}
	free_slot->used = true;
	strncpy(free_slot->name, name, sizeof(free_slot->name) - 1u);
	memcpy(free_slot->data, data, len);
	free_slot->len = len;
	return 0;
}

void kv_replay(struct dlv *d)
{
	size_t i;

	for (i = 0; i < ARRAY_SIZE(kv); i++) {
		if (kv[i].used) {
			dlv_restore(d, kv[i].name, kv[i].data, kv[i].len);
		}
	}
}

size_t kv_count(void)
{
	size_t i, n = 0u;

	for (i = 0; i < ARRAY_SIZE(kv); i++) {
		n += kv[i].used ? 1u : 0u;
	}
	return n;
}

bool kv_get(const char *name, void *data, size_t *len)
{
	size_t i;

	for (i = 0; i < ARRAY_SIZE(kv); i++) {
		if (kv[i].used && strcmp(kv[i].name, name) == 0) {
			memcpy(data, kv[i].data, kv[i].len);
			*len = kv[i].len;
			return true;
		}
	}
	return false;
}

/* ---- Outbound mesh messages ---- */

struct sent_msg sent_log[128];
size_t sent_n;
void (*send_probe)(uint8_t op, const uint8_t *params, size_t len);

void sent_clear(void)
{
	sent_n = 0u;
}

void record_send(void *ctx, uint8_t op, const uint8_t *params, size_t len)
{
	ARG_UNUSED(ctx);
	zassert_true(len <= CTAG_MESH_MAX_VENDOR_PARAMS);
	if (send_probe != NULL) {
		send_probe(op, params, len);
	}
	if (sent_n < ARRAY_SIZE(sent_log)) {
		sent_log[sent_n].op = op;
		sent_log[sent_n].len = (uint8_t)len;
		memcpy(sent_log[sent_n].data, params, len);
		sent_n++;
	}
}

size_t sent_count(uint8_t op)
{
	size_t i, n = 0u;

	for (i = 0; i < sent_n; i++) {
		n += sent_log[i].op == op ? 1u : 0u;
	}
	return n;
}

bool last_result(uint64_t update_id, struct ctag_mesh_delivery_result *r)
{
	bool found = false;
	size_t i;

	for (i = 0; i < sent_n; i++) {
		struct ctag_mesh_delivery_result m;

		if (sent_log[i].op == CTAG_MESH_OP_DELIVERY_RESULT &&
		    ctag_mesh_delivery_result_unpack(&m, sent_log[i].data, sent_log[i].len) == 0 &&
		    m.update_id == update_id) {
			*r = m;
			found = true;
		}
	}
	return found;
}

size_t results_for(uint64_t update_id)
{
	size_t i, n = 0u;

	for (i = 0; i < sent_n; i++) {
		struct ctag_mesh_delivery_result m;

		if (sent_log[i].op == CTAG_MESH_OP_DELIVERY_RESULT &&
		    ctag_mesh_delivery_result_unpack(&m, sent_log[i].data, sent_log[i].len) == 0 &&
		    m.update_id == update_id) {
			n++;
		}
	}
	return n;
}

void assert_one_seq_per_update(void)
{
	size_t i, k;

	for (i = 0; i < sent_n; i++) {
		struct ctag_mesh_delivery_result a, b;

		if (sent_log[i].op != CTAG_MESH_OP_DELIVERY_RESULT ||
		    ctag_mesh_delivery_result_unpack(&a, sent_log[i].data, sent_log[i].len) != 0) {
			continue;
		}
		for (k = i + 1u; k < sent_n; k++) {
			if (sent_log[k].op != CTAG_MESH_OP_DELIVERY_RESULT ||
			    ctag_mesh_delivery_result_unpack(&b, sent_log[k].data, sent_log[k].len) !=
				    0) {
				continue;
			}
			if (a.update_id == b.update_id) {
				zassert_equal(a.result_seq, b.result_seq,
					      "update_id %llu: result_seq %u and %u",
					      (unsigned long long)a.update_id, a.result_seq,
					      b.result_seq);
				zassert_true(a.status == b.status && a.tag_id == b.tag_id &&
						     a.epoch == b.epoch && a.revision == b.revision &&
						     memcmp(a.digest, b.digest, sizeof(a.digest)) == 0,
					     "update_id %llu: another result",
					     (unsigned long long)a.update_id);
			} else {
				zassert_not_equal(a.result_seq, b.result_seq,
						  "result_seq %u for two update_ids", a.result_seq);
			}
		}
	}
}

/* ---- Environment ---- */

void env_boot(uint32_t now)
{
	struct dlv_env env = {
		.send = record_send,
		.save = kv_save,
		.flash = &benv.flash,
		.fonts = &benv.fonts,
		.sha = &test_sha,
	};

	zassert_ok(ctag_crypto_init());
	benv.flash_ok = bflash_init(&benv.flash, EXT_FLASH_DEV, CONFIG_CTAG_BRIDGE_WORKING_SPACE) == 0;
	fontstore_init(&benv.fonts, &benv.flash, benv.flash_ok);
	env.flash_ok = benv.flash_ok;
	dlv_init(&benv.dlv, &env);
	kv_replay(&benv.dlv);
	dlv_start(&benv.dlv, now);
	small_layout = v_layouts_valid[0].data;
	small_layout_len = v_layouts_valid[0].len;
}

void env_fresh(uint32_t now)
{
	save_probe = NULL;
	send_probe = NULL;
	flash_wipe();
	kv_clear();
	sent_clear();
	env_boot(now);
}

uint8_t install_pack(const uint8_t *pack, size_t len, size_t chunk)
{
	uint8_t digest[32];
	uint8_t id[CTAG_FONTPACK_ID_LEN];
	uint8_t slot;
	size_t off;
	uint8_t st;

	sha256(pack, len, digest);
	st = fontstore_begin(&benv.fonts, (uint32_t)len, digest, &pack[16], &slot);
	for (off = 0u; st == CTAG_STATUS_OK && off < len; off += chunk) {
		st = fontstore_data(&benv.fonts, (uint32_t)off, &pack[off], MIN(chunk, len - off));
	}
	if (st == CTAG_STATUS_OK) {
		st = fontstore_commit(&benv.fonts, &test_sha, scratch, 1000u, id);
	}
	return st;
}

void install_fixture_pack(void)
{
	zassert_equal(install_pack(fixture_pack, fixture_pack_len, 700u), CTAG_STATUS_OK);
}

/* ---- Layout delivery ---- */

void layout_digest(const uint8_t *layout, size_t len, uint8_t digest[CTAG_LAYOUT_DIGEST_LEN])
{
	uint8_t full[32];

	sha256(layout, len, full);
	memcpy(digest, full, CTAG_LAYOUT_DIGEST_LEN);
}

void transfer(struct dlv *d, const struct xfer *x, const uint8_t *layout, size_t len,
	      uint32_t skip)
{
	struct ctag_mesh_layout_begin b = {
		.xfer_id = x->xfer_id,
		.tag_id = x->tag_id,
		.epoch = x->epoch,
		.revision = x->revision,
		.update_id = x->update_id,
		.total_len = (uint16_t)len,
		.chunk_count = (uint8_t)DIV_ROUND_UP(len, CTAG_LAYOUT_CHUNK_DATA_MAX),
	};
	size_t i;

	memcpy(b.fontpack_id, x->fontpack_id != NULL ? x->fontpack_id : fixture_pack_id, 8);
	layout_digest(layout, len, b.digest);
	dlv_layout_begin(d, &b);
	for (i = 0; i < b.chunk_count; i++) {
		struct ctag_mesh_layout_chunk c = {
			.xfer_id = x->xfer_id,
			.index = (uint8_t)i,
			.data = &layout[i * CTAG_LAYOUT_CHUNK_DATA_MAX],
			.data_len = MIN((size_t)CTAG_LAYOUT_CHUNK_DATA_MAX,
					len - i * CTAG_LAYOUT_CHUNK_DATA_MAX),
		};

		if (!(skip & BIT(i))) {
			dlv_layout_chunk(d, &c);
		}
	}
}

uint8_t deliver(struct dlv *d, const struct xfer *x, const uint8_t *layout, size_t len,
		uint32_t skip, uint32_t now, uint32_t *missing)
{
	uint32_t dummy;

	transfer(d, x, layout, len, skip);
	return dlv_layout_commit(d, x->xfer_id, now, missing != NULL ? missing : &dummy);
}

void assign(struct dlv *d, uint32_t tag_id, uint32_t epoch, const uint8_t key[16])
{
	struct ctag_mesh_assign_set m = {.tag_id = tag_id, .epoch = epoch, .flags = 1u};

	if (key != NULL) {
		memcpy(m.key, key, sizeof(m.key));
	}
	zassert_equal(dlv_assign_set(d, &m, 0u), CTAG_STATUS_OK);
}

size_t big_layout(uint8_t *out)
{
	struct ctag_layout_header h = {
		.magic = CTAG_LAYOUT_MAGIC,
		.version = CTAG_PROTO_VERSION,
		.width = 400,
		.height = 300,
		.cmd_count = 2 + 184,
	};
	size_t pos = (size_t)ctag_layout_header_pack(&h, out, CTAG_LAYOUT_HEADER_LEN);
	int run, i;

	for (run = 0; run < 2; run++) {
		struct ctag_layout_cmd_glyphs g = {
			.face = 1, .size_px = 16, .color = 1, .origin_x = 10,
			.origin_y = (int16_t)(40 + run * 40), .count = 255,
		};

		out[pos++] = CTAG_LAYOUT_CMD_GLYPHS;
		pos += (size_t)ctag_layout_cmd_glyphs_pack(&g, &out[pos], CTAG_LAYOUT_CMD_GLYPHS_LEN);
		for (i = 0; i < 255; i++) {
			struct ctag_layout_glyph e = {.glyph_id = (uint16_t)(i % 20), .dx = 1, .dy = 0};

			pos += (size_t)ctag_layout_glyph_pack(&e, &out[pos], CTAG_LAYOUT_GLYPH_LEN);
		}
	}
	for (i = 0; i < 184; i++) {
		struct ctag_layout_cmd_rect r = {
			.x = (int16_t)(i * 2), .y = (int16_t)(i % 280), .w = 10, .h = 5,
			.border = (uint8_t)(i % 3), .color = (uint8_t)(1 + i % 2),
		};

		out[pos++] = CTAG_LAYOUT_CMD_RECT;
		pos += (size_t)ctag_layout_cmd_rect_pack(&r, &out[pos], CTAG_LAYOUT_CMD_RECT_LEN);
	}
	zassert_equal(pos, CTAG_LAYOUT_HARD_MAX);
	zassert_equal(ctag_layout_validate(out, pos, NULL, NULL), CTAG_STATUS_OK);
	return pos;
}
```

## src/common.h
```c
/* Shared fixtures of the bridge core tests. */
#ifndef BRIDGE_TEST_COMMON_H_
#define BRIDGE_TEST_COMMON_H_

#include <stdbool.h>
#include <stddef.h>
#include <stdint.h>

#include <zephyr/device.h>
#include <zephyr/ztest.h>

#include <ctag/ctag_crypto.h>
#include <ctag/ctag_layout.h>
#include <ctag/proto_msgs.h>

#include "bflash.h"
#include "delivery.h"
#include "fontstore.h"

#define EXT_FLASH_DEV DEVICE_DT_GET(DT_CHOSEN(cremind_bridge_flash))
#define MIB           (1024u * 1024u)

extern const struct ctag_sha256_ops test_sha;

/* The simulated part: erased in place (fast), raw access for corruption. */
void flash_wipe(void);
uint8_t *flash_mem(void);
/* Power-cut injection: the next writes stop (-EIO) after `bytes` more bytes;
 * a negative value disables it. */
void flash_cut_after(int32_t bytes);

void sha256(const void *data, size_t len, uint8_t out[32]);

/* ---- Persistence fake (settings) ---- */
void kv_clear(void);
int kv_save(void *ctx, const char *name, const void *data, size_t len);
void kv_replay(struct dlv *d);
/* Called on every save before it is stored (NULL: none). */
extern void (*save_probe)(const char *name);
size_t kv_count(void);
bool kv_get(const char *name, void *data, size_t *len);

/* ---- Outbound mesh messages ---- */
struct sent_msg {
	uint8_t op;
	uint8_t len;
	uint8_t data[CTAG_MESH_MAX_VENDOR_PARAMS];
};

extern struct sent_msg sent_log[128];
extern size_t sent_n;
void sent_clear(void);
void record_send(void *ctx, uint8_t op, const uint8_t *params, size_t len);
/* Called on every outbound message before it is logged (NULL: none). */
extern void (*send_probe)(uint8_t op, const uint8_t *params, size_t len);
size_t sent_count(uint8_t op);
/* The last DELIVERY_RESULT for update_id; false when none. */
bool last_result(uint64_t update_id, struct ctag_mesh_delivery_result *r);
size_t results_for(uint64_t update_id);
/* 10: every DELIVERY_RESULT sent for an update_id is the same message with
 * the same result_seq, and different update_ids never share a result_seq. */
void assert_one_seq_per_update(void);

/* ---- A booted bridge core (flash, fonts, delivery) ---- */
struct bridge_env {
	struct bflash flash;
	struct fontstore fonts;
	struct dlv dlv;
	bool flash_ok;
};

extern struct bridge_env benv;
extern uint8_t scratch[CTAG_LAYOUT_HARD_MAX];

/* Boot from the current flash and persisted records (a reset keeps both). */
void env_boot(uint32_t now);
/* Fresh device: erase the flash, forget settings, boot. */
void env_fresh(uint32_t now);
/* Install a pack over the store's FONT_* path in chunks of `chunk` bytes. */
uint8_t install_pack(const uint8_t *pack, size_t len, size_t chunk);
void install_fixture_pack(void);
extern const uint8_t *fixture_pack;
extern size_t fixture_pack_len;
extern const uint8_t *fixture_pack_id;

/* ---- Layout delivery over LAYOUT_BEGIN / CHUNK / COMMIT ---- */
struct xfer {
	uint16_t xfer_id;
	uint32_t tag_id;
	uint32_t epoch;
	uint32_t revision;
	uint64_t update_id;
	const uint8_t *fontpack_id; /* NULL: the fixture pack */
};

void layout_digest(const uint8_t *layout, size_t len, uint8_t digest[CTAG_LAYOUT_DIGEST_LEN]);
/* Begin + every chunk (skip: bitmap of chunks not sent), no commit. */
void transfer(struct dlv *d, const struct xfer *x, const uint8_t *layout, size_t len,
	      uint32_t skip);
/* transfer() + commit. */
uint8_t deliver(struct dlv *d, const struct xfer *x, const uint8_t *layout, size_t len,
		uint32_t skip, uint32_t now, uint32_t *missing);
void assign(struct dlv *d, uint32_t tag_id, uint32_t epoch, const uint8_t key[16]);

/* A valid fixture layout (status_card) and a 4096-byte one built in code. */
extern const uint8_t *small_layout;
extern size_t small_layout_len;
size_t big_layout(uint8_t *out); /* LAYOUT_HARD_MAX bytes, valid for the fixture pack */

#endif /* BRIDGE_TEST_COMMON_H_ */
```

## src/test_bflash.c
```c
/* External flash: geometry, slot directory (power-cut atomicity), pending records. */
#include <string.h>

#include "common.h"

ZTEST(bridge_flash, test_geometry)
{
	struct bflash_geom g;

	/* nRF52840 DK development target: 8 MiB MX25R64, 1 MiB working space
	 * (what `cremind-tag fonts image` assumes for that board). */
	zassert_ok(bflash_geom_compute(8u * MIB, 1u * MIB, &g));
	zassert_equal(g.slot_size, 3584u * 1024u);
	zassert_equal(g.dir_off, 7u * MIB);
	zassert_equal(g.pending_off, 7u * MIB + CTAG_FONTPACK_DIR_SIZE);
	zassert_equal(g.pending_slots, (1u * MIB - 2u * 65536u) / BFLASH_PENDING_SLOT);
	zassert_equal(g.pending_end + BFLASH_SPARE, 8u * MIB);

	/* Production rule: 16 MiB working space. 64 MiB part. */
	zassert_ok(bflash_geom_compute(64u * MIB, 16u * MIB, &g));
	zassert_equal(g.slot_size, 24u * MIB);
	zassert_equal(g.dir_off, 48u * MIB);
	zassert_equal(g.pending_slots, (16u * MIB - 2u * 65536u) / BFLASH_PENDING_SLOT);
	/* A larger working space: the ring is capped. */
	zassert_ok(bflash_geom_compute(128u * MIB, 64u * MIB, &g));
	zassert_equal(g.pending_slots, BFLASH_PENDING_MAX);

	/* Odd sizes round the slots down to 64 KiB. */
	zassert_ok(bflash_geom_compute(24u * MIB + 4096u, 16u * MIB, &g));
	zassert_equal(g.slot_size, 4u * MIB);

	/* A part not larger than the working space has no pack slots. */
	zassert_ok(bflash_geom_compute(16u * MIB, 16u * MIB, &g));
	zassert_equal(g.slot_size, 0u);
	zassert_equal(bflash_geom_compute(8u * MIB, 16u * MIB, &g), -ENOSPC);
	zassert_equal(bflash_geom_compute(8u * MIB, 64u * 1024u, &g), -ENOSPC);
	zassert_equal(bflash_geom_compute(8u * MIB + 1u, 1u * MIB, &g), -EINVAL);
	zassert_equal(bflash_geom_compute(0u, 1u * MIB, &g), -EINVAL);
}

ZTEST(bridge_flash, test_large_part_address_map)
{
	/* The simulated 32 MiB part: slots below 16 MiB, directory and ring above. */
	env_fresh(0u);
	zassert_true(benv.flash_ok);
	zassert_equal(benv.flash.geom.flash_size, 32u * MIB);
	zassert_equal(benv.flash.geom.slot_size, 8u * MIB);
	zassert_equal(benv.flash.geom.dir_off, 16u * MIB);
	zassert_true(benv.flash.geom.pending_end <= 32u * MIB - BFLASH_SPARE);

	/* Reads and writes across the 16 MiB boundary and at the end of the part. */
	uint8_t w[8] __aligned(4) = {1, 2, 3, 4, 5, 6, 7, 8};
	uint8_t r[8];

	zassert_ok(bflash_erase(&benv.flash, 16u * MIB - 4096u, 8192u));
	zassert_ok(bflash_write(&benv.flash, 16u * MIB - 4u, w, sizeof(w)));
	zassert_ok(bflash_read(&benv.flash, 16u * MIB - 4u, r, sizeof(r)));
	zassert_mem_equal(r, w, sizeof(w));
	zassert_ok(bflash_erase(&benv.flash, 32u * MIB - 4096u, 4096u));
	zassert_ok(bflash_write(&benv.flash, 32u * MIB - 8u, w, sizeof(w)));
	zassert_ok(bflash_cached_read(&benv.flash, 32u * MIB - 8u, r, sizeof(r)));
	zassert_mem_equal(r, w, sizeof(w));
	zassert_equal(bflash_read(&benv.flash, 32u * MIB - 4u, r, 8u), -EINVAL);
	/* Writes are 4-byte units at 4-byte offsets. */
	zassert_equal(bflash_write(&benv.flash, 32u * MIB - 4096u + 2u, w, 4u), -EINVAL);
	zassert_equal(bflash_write(&benv.flash, 32u * MIB - 4096u, w, 3u), -EINVAL);
}

ZTEST(bridge_flash, test_directory_records)
{
	struct bflash_dir_record r = {.seq = 7, .slot = 1, .size = 2087};
	struct bflash_dir_record back;
	uint8_t buf[BFLASH_DIR_LEN];

	memcpy(r.pack_id, fixture_pack_id, 8);
	memset(r.content_hash, 0xA5, sizeof(r.content_hash));
	bflash_dir_encode(&r, buf);
	/* Layout of fontpack.md 3 (Cremind's app/tags/runtime/fonts/image.py slot_dir_record). */
	zassert_equal(buf[0], 'C');
	zassert_equal(buf[1], 'T');
	zassert_equal(buf[2], 'S');
	zassert_equal(buf[3], 'L');
	zassert_equal(ctag_get_le16(&buf[4]), 1);
	zassert_equal(ctag_get_le32(&buf[8]), 7);
	zassert_equal(buf[12], 1);
	zassert_mem_equal(&buf[16], fixture_pack_id, 8);
	zassert_equal(ctag_get_le32(&buf[24]), 2087);
	zassert_true(bflash_dir_decode(buf, 8u * MIB, &back));
	zassert_equal(back.seq, 7);
	buf[30] ^= 1;
	zassert_false(bflash_dir_decode(buf, 8u * MIB, &back), "CRC");
	buf[30] ^= 1;
	zassert_false(bflash_dir_decode(buf, 1000u, &back), "size above the slot");
}

static uint8_t hash[32];

static void activate(uint8_t slot, uint32_t size)
{
	memset(hash, slot, sizeof(hash));
	zassert_ok(bflash_dir_activate(&benv.flash, slot, fixture_pack_id, size, hash));
}

ZTEST(bridge_flash, test_directory_ab)
{
	struct bflash_dir_record r;
	uint8_t which;

	env_fresh(0u);
	zassert_equal(bflash_dir_active(&benv.flash, &r, &which), -ENOENT);
	activate(0, 100);
	zassert_ok(bflash_dir_active(&benv.flash, &r, &which));
	zassert_equal(r.seq, 1);
	zassert_equal(which, 0, "the first record goes to sector A");
	activate(1, 200);
	zassert_ok(bflash_dir_active(&benv.flash, &r, &which));
	zassert_equal(r.seq, 2);
	zassert_equal(r.slot, 1);
	zassert_equal(which, 1, "activation writes the other sector");
	activate(0, 300);
	zassert_ok(bflash_dir_active(&benv.flash, &r, &which));
	zassert_equal(r.seq, 3);
	zassert_equal(which, 0);
	zassert_equal(r.size, 300);
}

/*
 * Power loss at every byte of an activation (fontpack.md 3: "a power loss at
 * any moment leaves the previous record valid"): the erase of the other sector
 * and each of the 64 record bytes.
 */
ZTEST(bridge_flash, test_directory_power_cut)
{
	struct bflash_dir_record r;
	int32_t k;

	for (k = 0; k <= (int32_t)BFLASH_DIR_LEN; k++) {
		env_fresh(0u);
		activate(0, 100);
		activate(1, 200); /* active: seq 2, slot 1, in sector B */
		flash_cut_after(k);
		(void)bflash_dir_activate(&benv.flash, 0, fixture_pack_id, 300, hash);
		flash_cut_after(-1);
		zassert_ok(bflash_dir_active(&benv.flash, &r, NULL), "no active record after cut %d", k);
		if (k < (int32_t)BFLASH_DIR_LEN) {
			zassert_equal(r.seq, 2, "cut after %d bytes", k);
			zassert_equal(r.slot, 1);
			zassert_equal(r.size, 200);
		} else {
			zassert_equal(r.seq, 3, "all 64 bytes written");
			zassert_equal(r.slot, 0);
		}
	}
	/* Power lost before the erase of the target sector even started. */
	env_fresh(0u);
	activate(0, 100);
	activate(1, 200);
	activate(0, 300); /* sector A: seq 3; B: seq 2 */
	flash_cut_after(0);
	zassert_not_equal(bflash_dir_activate(&benv.flash, 1, fixture_pack_id, 400, hash), 0);
	flash_cut_after(-1);
	zassert_ok(bflash_dir_active(&benv.flash, &r, NULL));
	zassert_equal(r.seq, 3);
	zassert_equal(r.size, 300);
}

ZTEST(bridge_flash, test_pending_records)
{
	struct bflash_pending h = {
		.seq = 5, .tag_id = 0x1234, .epoch = 2, .revision = 9, .update_id = 77, .len = 0,
	};
	struct bflash_pending back;
	static uint8_t big[CTAG_LAYOUT_HARD_MAX];
	size_t n = big_layout(big);

	env_fresh(0u);
	memset(h.digest, 0x11, sizeof(h.digest));
	memcpy(h.fontpack_id, fixture_pack_id, 8);
	/* Odd length (tail padding) and the maximum length. */
	h.len = 141;
	zassert_ok(bflash_pending_write(&benv.flash, 0, &h, big));
	zassert_equal(bflash_pending_read(&benv.flash, 0, &back, scratch, sizeof(scratch)), 1);
	zassert_equal(back.len, 141);
	zassert_equal(back.update_id, 77);
	zassert_mem_equal(scratch, big, 141);
	h.len = (uint16_t)n;
	zassert_ok(bflash_pending_write(&benv.flash, 1, &h, big));
	zassert_equal(bflash_pending_read(&benv.flash, 1, &back, scratch, sizeof(scratch)), 1);
	zassert_mem_equal(scratch, big, n);
	/* Consumed: one write of the last word, no erase. */
	zassert_ok(bflash_pending_consume(&benv.flash, 1));
	zassert_equal(bflash_pending_peek(&benv.flash, 1, &back), BFLASH_PENDING_CONSUMED);
	zassert_equal(bflash_pending_read(&benv.flash, 1, &back, scratch, sizeof(scratch)), 0);
	zassert_ok(bflash_pending_consume(&benv.flash, 1), "consuming twice is harmless");
	/* A flipped layout bit fails the CRC. */
	flash_mem()[bflash_pending_offset(&benv.flash, 0) + BFLASH_PENDING_HDR + 10] ^= 0x01;
	zassert_equal(bflash_pending_read(&benv.flash, 0, &back, scratch, sizeof(scratch)), 0);
	/* Torn writes: the header goes last, so a cut anywhere leaves no record. */
	for (int32_t k = 0; k < 141 + 3 + (int32_t)BFLASH_PENDING_HDR; k += 7) {
		h.len = 141;
		flash_cut_after(k);
		(void)bflash_pending_write(&benv.flash, 2, &h, big);
		flash_cut_after(-1);
		zassert_equal(bflash_pending_read(&benv.flash, 2, &back, scratch, sizeof(scratch)), 0,
			      "torn record visible after %d bytes", k);
	}
	zassert_equal(bflash_pending_peek(&benv.flash, benv.flash.geom.pending_slots, &back),
		      -EINVAL);
}

/* A transfer assembled in place: chunks at their stride, header last. */
ZTEST(bridge_flash, test_pending_assembly)
{
	static uint8_t big[CTAG_LAYOUT_HARD_MAX];
	size_t n = big_layout(big);
	struct bflash_pending h = {.seq = 9, .tag_id = 1, .epoch = 1, .revision = 1,
				   .update_id = 5, .len = (uint16_t)n, .xfer_id = 0xBEEF};
	struct bflash_pending back;
	int i;

	env_fresh(0u);
	memcpy(h.fontpack_id, fixture_pack_id, 8);
	zassert_ok(bflash_pending_erase(&benv.flash, 3));
	for (i = 27; i >= 0; i--) {
		zassert_ok(bflash_pending_put(&benv.flash, 3, (unsigned int)i, &big[i * 150],
					      MIN(150u, n - (size_t)i * 150u)));
	}
	/* NOR is written once per erase: a chunk cannot be written again. */
	zassert_not_equal(bflash_pending_put(&benv.flash, 3, 4, big, 150), 0);
	zassert_equal(bflash_pending_peek(&benv.flash, 3, &back), BFLASH_PENDING_EMPTY);
	zassert_ok(bflash_pending_body(&benv.flash, 3, scratch, n));
	zassert_mem_equal(scratch, big, n);
	zassert_ok(bflash_pending_seal(&benv.flash, 3, &h, big));
	zassert_equal(bflash_pending_check(&benv.flash, 3, &back, scratch, sizeof(scratch)),
		      BFLASH_PENDING_LIVE);
	zassert_equal(back.xfer_id, 0xBEEF);
	zassert_equal(back.len, n);
	zassert_ok(bflash_pending_consume(&benv.flash, 3));
	zassert_equal(bflash_pending_check(&benv.flash, 3, &back, scratch, sizeof(scratch)),
		      BFLASH_PENDING_CONSUMED, "a consumed record is still intact");
	/* A sealed header over other bytes fails the CRC. */
	zassert_ok(bflash_pending_erase(&benv.flash, 4));
	zassert_ok(bflash_pending_put(&benv.flash, 4, 0, big, 150));
	h.len = 150;
	big[0] ^= 1;
	zassert_ok(bflash_pending_seal(&benv.flash, 4, &h, big));
	big[0] ^= 1;
	zassert_equal(bflash_pending_check(&benv.flash, 4, &back, scratch, sizeof(scratch)),
		      BFLASH_PENDING_EMPTY);
	/* Arguments. */
	zassert_equal(bflash_pending_put(&benv.flash, 5, BFLASH_PENDING_CHUNKS, big, 10), -EINVAL);
	zassert_equal(bflash_pending_put(&benv.flash, 5, 0, big, 151), -EINVAL);
	zassert_equal(bflash_pending_put(&benv.flash, 5, 0, big, 0), -EINVAL);
	zassert_equal(bflash_pending_erase(&benv.flash, benv.flash.geom.pending_slots), -EINVAL);
}

ZTEST(bridge_flash, test_read_cache)
{
	uint8_t w[256] __aligned(4);
	uint8_t r[40];
	uint32_t base = 20u * MIB;
	uint32_t hits;

	env_fresh(0u);
	for (size_t i = 0; i < sizeof(w); i++) {
		w[i] = (uint8_t)i;
	}
	zassert_ok(bflash_erase(&benv.flash, base, 4096u));
	zassert_ok(bflash_write(&benv.flash, base, w, sizeof(w)));
	/* Reads that straddle a line boundary. */
	zassert_ok(bflash_cached_read(&benv.flash, base + CONFIG_CTAG_BRIDGE_READ_CACHE_LINE - 7u,
				      r, sizeof(r)));
	zassert_mem_equal(r, &w[CONFIG_CTAG_BRIDGE_READ_CACHE_LINE - 7u], sizeof(r));
	hits = benv.flash.hits;
	zassert_ok(bflash_cached_read(&benv.flash, base + 3u, r, 10u));
	zassert_equal(benv.flash.hits, hits + 1u);
	zassert_mem_equal(r, &w[3], 10u);
	/* Invalidation: rewritten flash is read again. */
	zassert_ok(bflash_erase(&benv.flash, base, 4096u));
	bflash_cache_invalidate(&benv.flash);
	zassert_ok(bflash_cached_read(&benv.flash, base + 3u, r, 10u));
	zassert_equal(r[0], 0xFF);
}

ZTEST_SUITE(bridge_flash, NULL, NULL, NULL, NULL, NULL);
```

## src/test_fontstore.c
```c
/* Font store: installation, boot validation, slot flip, FLASH_TEST. */
#include <string.h>

#include "common.h"

static uint8_t pack_copy[4096];

ZTEST(bridge_fonts, test_install_and_boot)
{
	uint8_t id[8];
	struct bflash_dir_record r;

	env_fresh(0u);
	zassert_false(fontstore_active_id(&benv.fonts, id));
	/* Odd chunk sizes exercise the 4-byte write carry. */
	zassert_equal(install_pack(fixture_pack, fixture_pack_len, 333u), CTAG_STATUS_OK);
	zassert_true(fontstore_active_id(&benv.fonts, id));
	zassert_mem_equal(id, fixture_pack_id, 8);
	zassert_equal(benv.fonts.active.slot, 0);
	zassert_true(fontstore_has_strike(&benv.fonts, 1, 16));
	zassert_false(fontstore_has_strike(&benv.fonts, 1, 32));
	/* A reset: the directory and the pack are validated again at boot. */
	env_boot(0u);
	zassert_true(fontstore_active_id(&benv.fonts, id));
	/* The next install goes to the other slot and flips the directory. */
	zassert_equal(install_pack(fixture_pack, fixture_pack_len, 1u), CTAG_STATUS_OK);
	zassert_equal(benv.fonts.active.slot, 1);
	zassert_ok(bflash_dir_active(&benv.flash, &r, NULL));
	zassert_equal(r.seq, 2);
	zassert_equal(r.size, fixture_pack_len);
}

ZTEST(bridge_fonts, test_boot_rejects_corrupt_pack)
{
	uint8_t id[8];
	uint32_t base;

	env_fresh(0u);
	install_fixture_pack();
	base = bflash_slot_offset(&benv.flash, benv.fonts.active.slot);
	/* A glyph index byte: the strike's index CRC fails at boot. */
	flash_mem()[base + 304 + 5] ^= 0x10;
	env_boot(0u);
	zassert_true(benv.fonts.has_record);
	zassert_false(fontstore_active_id(&benv.fonts, id), "a corrupt pack is not active");
	zassert_equal(benv.fonts.last_open_status, CTAG_STATUS_CRC_ERROR);
	/* ... and FONT_BEGIN still targets the other slot (the record stays). */
	uint8_t digest[32] = {0};
	uint8_t slot;

	zassert_equal(fontstore_begin(&benv.fonts, 100, digest, fixture_pack_id, &slot),
		      CTAG_STATUS_OK);
	zassert_equal(slot, 1);
	fontstore_abort(&benv.fonts);
}

ZTEST(bridge_fonts, test_install_errors)
{
	uint8_t digest[32];
	uint8_t id[8];
	uint8_t slot;

	env_fresh(0u);
	sha256(fixture_pack, fixture_pack_len, digest);
	/* Order of sim/flash.py: size checks at FONT_BEGIN. */
	zassert_equal(fontstore_begin(&benv.fonts, 0, digest, fixture_pack_id, &slot),
		      CTAG_STATUS_INVALID);
	zassert_equal(fontstore_begin(&benv.fonts, 8u * MIB + 1u, digest, fixture_pack_id, &slot),
		      CTAG_STATUS_TOO_LARGE);
	/* FONT_DATA without FONT_BEGIN, and out of sequence. */
	zassert_equal(fontstore_data(&benv.fonts, 0, fixture_pack, 10), CTAG_STATUS_NOT_FOUND);
	zassert_equal(fontstore_begin(&benv.fonts, (uint32_t)fixture_pack_len, digest,
				      fixture_pack_id, &slot),
		      CTAG_STATUS_OK);
	zassert_equal(fontstore_data(&benv.fonts, 10, fixture_pack, 10), CTAG_STATUS_INVALID);
	zassert_equal(fontstore_data(&benv.fonts, 0, fixture_pack, 0), CTAG_STATUS_INVALID);
	zassert_equal(fontstore_data(&benv.fonts, 0, fixture_pack, fixture_pack_len + 1u),
		      CTAG_STATUS_INVALID);
	zassert_equal(fontstore_data(&benv.fonts, 0, fixture_pack, 100), CTAG_STATUS_OK);
	/* Commit before every byte arrived. */
	zassert_equal(fontstore_commit(&benv.fonts, &test_sha, scratch, 512, id),
		      CTAG_STATUS_INCOMPLETE);
	zassert_equal(fontstore_commit(&benv.fonts, &test_sha, scratch, 512, id),
		      CTAG_STATUS_NOT_FOUND, "the install ended at the first commit");
	zassert_false(fontstore_active_id(&benv.fonts, id));

	/* A wrong FONT_BEGIN digest. */
	digest[0] ^= 1;
	zassert_equal(install_pack(fixture_pack, fixture_pack_len, 512), CTAG_STATUS_OK);
	zassert_equal(fontstore_begin(&benv.fonts, (uint32_t)fixture_pack_len, digest,
				      fixture_pack_id, &slot),
		      CTAG_STATUS_OK);
	zassert_equal(fontstore_data(&benv.fonts, 0, fixture_pack, fixture_pack_len),
		      CTAG_STATUS_OK);
	zassert_equal(fontstore_commit(&benv.fonts, &test_sha, scratch, 512, id),
		      CTAG_STATUS_DIGEST_MISMATCH);
	zassert_true(fontstore_active_id(&benv.fonts, id), "the active pack is untouched");
	zassert_equal(benv.fonts.active.slot, 0);

	/* A pack whose content hash does not match (right digest of the bytes). */
	memcpy(pack_copy, fixture_pack, fixture_pack_len);
	pack_copy[fixture_pack_len - 1] ^= 0x01; /* bitmap byte: CRCs pass, content hash fails */
	zassert_equal(install_pack(pack_copy, fixture_pack_len, 512),
		      CTAG_STATUS_DIGEST_MISMATCH);
	/* A pack id other than FONT_BEGIN's. */
	sha256(fixture_pack, fixture_pack_len, digest);
	zassert_equal(fontstore_begin(&benv.fonts, (uint32_t)fixture_pack_len, digest,
				      (const uint8_t *)"ABCDEFGH", &slot),
		      CTAG_STATUS_OK);
	zassert_equal(fontstore_data(&benv.fonts, 0, fixture_pack, fixture_pack_len),
		      CTAG_STATUS_OK);
	zassert_equal(fontstore_commit(&benv.fonts, &test_sha, scratch, 512, id),
		      CTAG_STATUS_INVALID);
	zassert_equal(benv.fonts.active.slot, 0);
	zassert_equal(benv.fonts.installs, 1);
}

ZTEST(bridge_fonts, test_session_view_blocks_overwrite)
{
	struct fontstore_view v;
	uint8_t digest[32];
	uint8_t slot;

	env_fresh(0u);
	install_fixture_pack(); /* slot 0 */
	zassert_true(fontstore_view_open(&benv.fonts, &v));
	install_fixture_pack(); /* slot 1 active; the view keeps reading slot 0 */
	zassert_equal(benv.fonts.active.slot, 1);
	sha256(fixture_pack, fixture_pack_len, digest);
	zassert_equal(fontstore_begin(&benv.fonts, (uint32_t)fixture_pack_len, digest,
				      fixture_pack_id, &slot),
		      CTAG_STATUS_BUSY, "slot 0 is still read by a session");
	zassert_true(v.src.has_strike(v.src.ctx, 1, 16), "the view still reads its slot");
	fontstore_view_close(&benv.fonts, &v);
	zassert_equal(fontstore_begin(&benv.fonts, (uint32_t)fixture_pack_len, digest,
				      fixture_pack_id, &slot),
		      CTAG_STATUS_OK);
	zassert_equal(slot, 0);
	fontstore_abort(&benv.fonts);
}

static size_t find(const struct fontstore_test_item *it, size_t n, uint32_t off)
{
	for (size_t i = 0; i < n; i++) {
		if (it[i].offset == off) {
			return i;
		}
	}
	return n;
}

ZTEST(bridge_fonts, test_flash_test)
{
	struct fontstore_test_item it[FONTSTORE_TEST_MAX];
	const uint32_t slot = 8u * MIB;
	size_t n, i;

	env_fresh(0u);
	/* No pack: slot 0 is the inactive one. Positions ascend. */
	n = fontstore_flash_test(&benv.fonts, it, ARRAY_SIZE(it));
	zassert_equal(n, 5);
	zassert_equal(it[0].offset, 0);
	zassert_equal(it[1].offset, slot - 4096u);
	zassert_equal(it[2].offset, 16u * MIB - 4096u, "below the 16 MiB boundary (slot 1)");
	zassert_equal(it[3].offset, 16u * MIB, "the 16 MiB boundary...");
	zassert_equal(it[3].status, CTAG_STATUS_BUSY, "...is directory sector A here");
	zassert_equal(it[4].offset, 32u * MIB - 4096u, "the device's last sector");
	for (i = 0; i < n; i++) {
		if (i != 3) {
			zassert_equal(it[i].status, CTAG_STATUS_OK, "item %zu", i);
		}
	}
	install_fixture_pack(); /* slot 0 active */
	n = fontstore_flash_test(&benv.fonts, it, ARRAY_SIZE(it));
	/* Inactive slot 1 = [8, 16) MiB: its first and last sectors; the last is
	 * also the sector below the 16 MiB boundary (de-duplicated). */
	zassert_equal(n, 4);
	zassert_equal(it[0].offset, slot);
	zassert_equal(it[1].offset, 16u * MIB - 4096u);
	zassert_equal(it[0].status, CTAG_STATUS_OK);
	zassert_equal(it[1].status, CTAG_STATUS_OK);
	zassert_equal(it[2].status, CTAG_STATUS_BUSY);
	zassert_equal(it[3].status, CTAG_STATUS_OK);
	/* The active pack survives. */
	env_boot(0u);
	zassert_true(benv.fonts.valid);
	/* The sector below 16 MiB now lies in the active slot. */
	install_fixture_pack(); /* slot 1 active, slot 0 inactive */
	n = fontstore_flash_test(&benv.fonts, it, ARRAY_SIZE(it));
	i = find(it, n, 16u * MIB - 4096u);
	zassert_true(i < n);
	zassert_equal(it[i].status, CTAG_STATUS_BUSY, "inside the active slot");
	zassert_equal(it[find(it, n, 0)].status, CTAG_STATUS_OK);
	/* An open installation makes every position BUSY. */
	uint8_t digest[32];
	uint8_t s;

	sha256(fixture_pack, fixture_pack_len, digest);
	zassert_equal(fontstore_begin(&benv.fonts, 100, digest, fixture_pack_id, &s), 0);
	n = fontstore_flash_test(&benv.fonts, it, ARRAY_SIZE(it));
	for (i = 0; i < n; i++) {
		zassert_equal(it[i].status, CTAG_STATUS_BUSY);
	}
	fontstore_abort(&benv.fonts);
	zassert_true(benv.fonts.valid);
}

ZTEST_SUITE(bridge_fonts, NULL, NULL, NULL, NULL, NULL);
```

## src/test_golden.c
```c
/*
 * Golden: the bridge's strip rendering of every protocol/fixtures/render.json
 * layout, with protocol/fixtures/fontpack_test.ctfp installed in the bridge's
 * external-flash store and read back through its cache, yields the fixture's
 * frame digest (render pre-pass) and plane digests (strip by strip).
 */
#include <string.h>

#include <ctag/ctag_render.h>

#include "common.h"
#include "v_render.h"

static uint8_t strip[CTAG_BRIDGE_STRIP_ROWS * 256];

ZTEST(bridge_golden, test_render_fixtures)
{
	struct fontstore_view view;
	struct ctag_render_work work;
	struct ctag_render r;

	env_fresh(0u);
	install_fixture_pack();
	/* Pack in the second slot: offsets above 8 MiB on this part. */
	install_fixture_pack();
	zassert_equal(benv.fonts.active.slot, 1);
	zassert_true(fontstore_view_open(&benv.fonts, &view));
	for (size_t i = 0; i < ARRAY_SIZE(v_render); i++) {
		const struct v_render *v = &v_render[i];
		struct ctag_render_panel panel = {v->width, v->height, v->planes, v->plane_flags};
		size_t rb = ctag_render_row_bytes(&panel);
		size_t rows = MIN((size_t)CTAG_BRIDGE_STRIP_ROWS, sizeof(strip) / rb);
		uint8_t digest[32];

		zassert_equal(ctag_render_init(&r, v->layout, v->len, &panel, &view.src, &work),
			      CTAG_STATUS_OK, "%s", v->name);
		/* FRAME_BEGIN.digest: the pre-pass over BRIDGE_STRIP_ROWS strips. */
		zassert_ok(ctag_render_frame_digest(&r, strip, rows * rb, &test_sha, digest));
		zassert_mem_equal(digest, v->frame_digest, 32, "%s: frame digest", v->name);
		/* The strips streamed as PLANE_DATA give each plane's digest. */
		for (uint8_t p = 0; p < v->planes; p++) {
			ctag_sha256_ctx c;

			zassert_ok(ctag_crypto_sha256_init(&c));
			for (uint32_t y = 0; y < v->height; y += (uint32_t)rows) {
				int n = ctag_render_strip(&r, p, (uint16_t)y, (uint16_t)rows, strip,
							  sizeof(strip));

				zassert_true(n > 0);
				zassert_ok(ctag_crypto_sha256_update(&c, strip, (size_t)n));
			}
			zassert_ok(ctag_crypto_sha256_finish(&c, digest));
			zassert_mem_equal(digest, v->plane_sha256[p], 32, "%s: plane %u", v->name, p);
		}
	}
	fontstore_view_close(&benv.fonts, &view);
	zassert_true(benv.flash.hits > benv.flash.misses, "the cache serves the renderer");
}

ZTEST_SUITE(bridge_golden, NULL, NULL, NULL, NULL, NULL);
```
