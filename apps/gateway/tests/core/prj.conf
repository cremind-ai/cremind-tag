## CMakeLists.txt
```
# Gateway core on native_sim (docs/gateway-firmware.md "Tests"): the same
# sources as apps/gateway/src/core with a mocked backend (mesh, persistence,
# serial output, the own radio) and a fake clock. testcase.yaml builds it three
# times: protocol v1; protocol v2 (CONFIG_CTAG_GW_SECURE, every suite through
# a secure session plus the gw_v2 suite) with the own radio
# (CONFIG_CTAG_GW_RADIO, the gw_radio suite); and v2 without it.
cmake_minimum_required(VERSION 3.20.0)
find_package(Zephyr REQUIRED HINTS $ENV{ZEPHYR_BASE})
project(ctag_gateway_core_test)

set(gw ${CMAKE_CURRENT_SOURCE_DIR}/../..)

target_sources(app PRIVATE
  ${gw}/src/core/gw_core.c
  ${gw}/src/core/gw_serial.c
  ${gw}/src/core/gw_lane.c
  ${gw}/src/core/gw_delivery.c
  ${gw}/src/core/gw_nodes.c
  ${gw}/src/core/gw_ring.c
  src/common.c
  src/test_serial.c
  src/test_delivery.c
  src/test_nodes.c
  src/test_ring.c)
target_sources_ifdef(CONFIG_CTAG_GW_SECURE app PRIVATE
  ${gw}/src/core/gw_secure.c
  ${gw}/src/core/gw_tunnel.c
  src/test_v2.c)
target_sources_ifdef(CONFIG_CTAG_GW_RADIO app PRIVATE
  ${gw}/src/core/gw_radio.c
  src/test_radio.c)
target_include_directories(app PRIVATE ${gw}/src/core src)
```

## Kconfig
```
rsource "../../Kconfig.gateway"

source "Kconfig.zephyr"
```

## prj.conf
```kconfig
CONFIG_ZTEST=y
CONFIG_ZTEST_STACK_SIZE=16384

CONFIG_CTAG_FRAME=y
CONFIG_CTAG_CBOR=y

# SHA-256 for LAYOUT_BEGIN.digest through PSA (Mbed TLS on the host).
CONFIG_PSA_CRYPTO=y
CONFIG_PSA_CRYPTO_PROVIDER_MBEDTLS=y
CONFIG_PSA_WANT_ALG_SHA_256=y
CONFIG_ENTROPY_GENERATOR=y

# Small queues so the limits are reached quickly: two queued records behind
# the active one, and an arena for two full-size layouts.
CONFIG_CTAG_GW_DELIVERY_QUEUE=2
CONFIG_CTAG_GW_LAYOUT_ARENA=8192
```

## src/common.h
```c
/* Shared fixtures of the gateway core tests: a mocked backend and a host. */
#ifndef GW_TEST_COMMON_H_
#define GW_TEST_COMMON_H_

#include <stdbool.h>
#include <stddef.h>
#include <stdint.h>

#include <zephyr/ztest.h>

#include <ctag/ctag_cbor.h>
#include <ctag/ctag_frame.h>
#include <ctag/proto_msgs.h>

#include "gw_core.h"

extern struct gw_core core;
extern int64_t now_ms;

#define BOOT_ID  0x12345678u
#define BRIDGE_A 0x0002u
#define BRIDGE_B 0x0003u

/* ---- Mocked backend ---- */

struct sent {
	uint16_t dst;
	uint8_t op;
	uint8_t len;
	uint32_t tag;
	uint8_t data[CTAG_MESH_MAX_VENDOR_PARAMS];
};

struct cfg_call {
	uint16_t addr;
	uint8_t step;
	uint8_t arg;
	uint32_t tag;
};

#ifdef CONFIG_CTAG_GW_RADIO
struct radio_write { /* a fragment the core handed to link_write() */
	uint8_t link;
	uint8_t chr;
	uint8_t len;
	uint8_t data[CTAG_ATT_VALUE_MAX];
};
#endif

struct mock {
	struct sent sent[512];
	size_t n_sent;
	struct cfg_call cfg[64];
	size_t n_cfg;
	int send_rc[16]; /* results of the next sends (then 0) */
	size_t send_rc_n;
	int cfg_rc;
	int provision_rc;
	uint8_t provisioned[8][16];
	size_t n_provision;
	uint16_t configured[8];
	size_t n_configured;
	uint16_t deleted[8];
	size_t n_deleted;
	size_t assign_stores;
	struct gw_assign stored_assign[32];
	size_t stored_assign_n;
	char stored_name[64];
	size_t stored_name_len;
	size_t reboots;
	size_t tx_room; /* bytes the "UART" accepts per write (SIZE_MAX = all) */
	/* v2 */
	uint8_t provision_oob[8][32];
	bool provision_oob_set[8];
	uint8_t stored_owner[176];
	size_t owner_writes;
	uint32_t stored_floor;
	bool owner_fail;
	bool random_fail; /* the backend's RNG (challenges) fails */
	size_t releases;
#ifdef CONFIG_CTAG_GW_RADIO
	/* the own radio (every mesh send asserts the mesh is not suspended) */
	bool listening;       /* the last radio_listen() */
	size_t listen_calls;
	bool suspended;       /* the mesh: between a successful suspend and resume */
	int suspend_rc;       /* bt_mesh_suspend() / bt_mesh_resume() results */
	int resume_rc;
	size_t suspends, resumes;
	int connect_rc;
	size_t connects;
	uint8_t connect_link;
	struct sched_peer connect_peer;
	uint32_t connect_timeout;
	size_t disconnects;
	uint8_t disconnect_link;
	int setup_rc;
	size_t setups;
	uint8_t setup_link, setup_mode;
	int write_rc[8]; /* results of the next link writes (then 0) */
	size_t write_rc_n;
	struct radio_write writes[256];
	size_t n_writes;
#endif
};

extern struct mock mock;

/* Fresh core with no session: BRIDGE_A (configured) and BRIDGE_B (not).
 * v2: owned by the test authority, the test worker's key pinned. */
void core_reset(void);
/* A HELLO'd session with a large host window; v2: then SECURE_OPEN as the
 * current worker (requests and answers are sealed from here on). */
void core_session(void);

#ifdef CONFIG_CTAG_GW_SECURE
#include <ctag/ctag_secure.h>

/* The test authority, owner and worker keys. */
extern const uint8_t test_auth_sk[32];
extern const uint8_t test_owner[16];
extern const uint8_t test_worker[32]; /* the pinned controller's private key */
extern const uint8_t test_other[32];  /* another computer's controller key */

/* v2: a fresh core that is unowned (factory state). */
void core_reset_unowned(void);
/* v2: a fresh core from these stored bytes and floor (the boot rule). */
void core_reset_record(const uint8_t *rec, size_t len, uint32_t floor);
/* v2: the worker key the next core_session()/host_open() uses. */
void host_use_worker(const uint8_t priv[32]);
/* v2: SECURE_OPEN from the current worker (after HELLO); returns its status. */
uint8_t host_open(void);
/* The same, granting this many credits with the SECURE_OPEN frame. */
uint8_t host_open_credits(uint8_t credits);
/* The same, with every gateway allocation after the first n failing. */
uint8_t host_open_fail_after(int32_t n);
/* v2: the host session is open (host_send seals). */
bool host_sealed(void);
/* v2: forget the host session (the next host_send goes in plaintext). */
void host_forget(void);
/* Send a request in plaintext whatever the session. */
uint16_t host_send_plain(uint8_t type, const struct ctag_cbor_field *f, size_t n, uint8_t credits);
/* A SECURE_DATA frame with these raw bytes as its data. */
uint16_t host_send_secure_raw(const uint8_t *data, size_t len, uint8_t credits);
/* Seal a secure message of this type/flags/rid with fields; returns the ciphertext length. */
int host_seal(uint8_t type, uint8_t flags, uint16_t rid, const struct ctag_cbor_field *f, size_t n,
	      uint8_t *out, size_t size);
/* The gateway's current challenge through STATUS (sealed). */
void host_challenge(uint8_t out[16]);
/* A grant of op for the gateway toward controller (the worker's public key). */
void host_grant(uint8_t op, const uint8_t controller[32], const uint8_t challenge[16],
		uint32_t gen_from, uint8_t *grant, size_t *len, uint8_t sig[64]);
/* CLAIM/RECOVER/RELEASE with a fresh challenge and a grant for the current worker. */
uint8_t host_grant_request(uint8_t type, uint8_t op, uint32_t gen_from);
#endif
/* Advance the clock and run the core's timers. */
void advance(int64_t ms);

size_t sent_count(uint8_t op);
const struct sent *last_sent(uint8_t op);
const struct sent *sent_at(size_t i);
void end_last(int err);        /* report the end of the last tagged send */
void end_tag(uint32_t tag, int err);

/* ---- Host side ---- */

struct frame {
	struct ctag_serial_header h;
	uint16_t len;
	uint8_t payload[CONFIG_CTAG_GW_TX_FRAME];
};

/* Send a request frame; returns its request id. credits = grant carried. */
uint16_t host_send(uint8_t type, const struct ctag_cbor_field *f, size_t n, uint8_t credits);
/* Raw bytes to the gateway. */
void host_bytes(const uint8_t *data, size_t len);
/* Bytes the gateway wrote that host_read() has not consumed yet. */
size_t capture_peek(const uint8_t **p);
/* Frames the gateway wrote since the last call (parsed from the capture). */
size_t host_read(void);
extern struct frame rx_frames[64];
extern size_t rx_count;
/* The response to rid among the frames read, or NULL. */
const struct frame *response(uint16_t rid);
/* The i-th event of a type among the frames read, or NULL. */
const struct frame *event(uint8_t type, size_t i);
size_t events_of(uint8_t type);
/* Decode the fields of a frame: keys set by the caller. */
void decode(const struct frame *fr, struct ctag_cbor_field *f, size_t n);
uint64_t field_u(const struct frame *fr, uint8_t key);
bool field_has(const struct frame *fr, uint8_t key);
/* A counter from INFO / GET_COUNTERS. */
uint32_t counter(const char *name);
/* Status of the response to a request: sends it, reads, returns status. */
uint8_t request_status(uint8_t type, const struct ctag_cbor_field *f, size_t n);

/* Convenience requests (op ids chosen by the caller). */
uint16_t send_deliver(uint64_t op_id, uint16_t bridge, uint64_t update_id, const uint8_t *layout,
		      size_t len);
uint16_t send_ack(uint32_t seq);

/* Mesh input helpers. */
void mesh_status(uint16_t src, uint16_t xfer_id, uint8_t status, uint32_t missing);
void mesh_result(uint16_t src, uint16_t result_seq, uint64_t update_id, uint8_t status);
/* A DELIVERY_RESULT with every field given. */
void mesh_result_msg(uint16_t src, const struct ctag_mesh_delivery_result *r);
void mesh_assign_status(uint16_t src, uint32_t tag_id, uint32_t epoch, uint8_t status);

/* Complete the segmented lane's sends until the commit, OK each end; returns
 * the xfer_id of the transfer. */
uint16_t drive_to_commit(void);

#endif /* GW_TEST_COMMON_H_ */
```

## src/test_delivery.c
```c
/* Delivery engine: queue, one outstanding segmented send, BEGIN/CHUNK/COMMIT,
 * INCOMPLETE rounds, commit time-outs, results and de-duplication (3.2-3.4, 10). */
#include <string.h>

#include <psa/crypto.h>

#include "common.h"

static uint8_t layout[4096];

static void before(void *f)
{
	(void)f;
	core_reset();
	core_session();
	for (size_t i = 0; i < sizeof(layout); i++) {
		layout[i] = (uint8_t)(i * 7u + 1u);
	}
}

ZTEST_SUITE(gw_delivery, NULL, NULL, before, NULL, NULL);

static uint8_t deliver_status(uint64_t op_id, uint16_t bridge, uint64_t update_id, size_t len)
{
	uint16_t rid = send_deliver(op_id, bridge, update_id, layout, len);

	host_read();
	zassert_not_null(response(rid));
	return (uint8_t)field_u(response(rid), CTAG_CBOR_KEY_STATUS);
}

static const struct frame *result_for(uint64_t update_id)
{
	for (size_t i = 0; i < events_of(CTAG_SERIAL_MSG_EVT_RESULT); i++) {
		const struct frame *e = event(CTAG_SERIAL_MSG_EVT_RESULT, i);

		if (field_u(e, CTAG_CBOR_KEY_UPDATE_ID) == update_id) {
			return e;
		}
	}
	return NULL;
}

static size_t tagged_in_flight(void)
{
	return core.lane.active >= 0 && core.lane.tag != 0u ? 1u : 0u;
}

ZTEST(gw_delivery, test_begin_chunks_commit_with_digest)
{
	struct ctag_mesh_layout_begin b;
	uint8_t digest[32];
	size_t olen;
	const struct sent *s;
	uint16_t xfer;

	zassert_equal(deliver_status(1u, BRIDGE_A, 501u, 400u), CTAG_STATUS_ACCEPTED);
	s = last_sent(CTAG_MESH_OP_LAYOUT_BEGIN);
	zassert_not_null(s);
	zassert_equal(s->dst, BRIDGE_A);
	zassert_not_equal(s->tag, 0u, "segmented: its end is reported");
	zassert_equal(ctag_mesh_layout_begin_unpack(&b, s->data, s->len), 0);
	zassert_equal(b.total_len, 400u);
	zassert_equal(b.chunk_count, 3u);
	zassert_equal(b.update_id, 501u);
	zassert_equal(b.tag_id, 0xCAFE0001u);
	zassert_equal(b.epoch, 3u);
	zassert_equal(b.revision, 18u);
	zassert_equal(psa_hash_compute(PSA_ALG_SHA_256, layout, 400u, digest, 32u, &olen),
		      PSA_SUCCESS);
	zassert_mem_equal(b.digest, digest, 16u, "digest = SHA-256(layout)[0:16]");
	zassert_equal(sent_count(CTAG_MESH_OP_LAYOUT_CHUNK), 0u, "no chunk before BEGIN's end");
	xfer = drive_to_commit();
	zassert_equal(xfer, b.xfer_id);
	zassert_equal(sent_count(CTAG_MESH_OP_LAYOUT_CHUNK), 3u);
	for (uint8_t i = 0; i < 3u; i++) {
		struct ctag_mesh_layout_chunk c = {0};
		const struct sent *cs = sent_at(1u + i);

		zassert_equal(cs->op, CTAG_MESH_OP_LAYOUT_CHUNK);
		zassert_equal(ctag_mesh_layout_chunk_unpack(&c, cs->data, cs->len), 0);
		zassert_equal(c.index, i);
		zassert_equal(c.xfer_id, b.xfer_id);
		zassert_equal(c.data_len, i < 2u ? 150u : 100u);
		zassert_mem_equal(c.data, &layout[i * 150u], c.data_len);
	}
	s = last_sent(CTAG_MESH_OP_LAYOUT_COMMIT);
	zassert_equal(s->tag, 0u, "LAYOUT_COMMIT is unsegmented");
	zassert_equal(s->len, CTAG_MESH_LAYOUT_COMMIT_LEN);
}

ZTEST(gw_delivery, test_one_segmented_send_outstanding_gateway_wide)
{
	static const uint8_t key[16];
	struct ctag_cbor_field f[5] = {
		GW_F_UINT(CTAG_CBOR_KEY_OP_ID, 70u), GW_F_UINT(CTAG_CBOR_KEY_BRIDGE, BRIDGE_A),
		GW_F_UINT(CTAG_CBOR_KEY_TAG_ID, 5u), GW_F_UINT(CTAG_CBOR_KEY_EPOCH, 1u),
		GW_F_BSTR(CTAG_CBOR_KEY_KEY, key, 16u),
	};

	zassert_equal(deliver_status(1u, BRIDGE_A, 501u, 300u), CTAG_STATUS_ACCEPTED);
	zassert_equal(request_status(CTAG_SERIAL_MSG_ASSIGN_TAG, f, 5u), CTAG_STATUS_ACCEPTED);
	zassert_equal(sent_count(CTAG_MESH_OP_ASSIGN_SET), 0u, "waits for LAYOUT_BEGIN's end");
	zassert_equal(tagged_in_flight(), 1u);
	end_last(0); /* BEGIN done: the queued ASSIGN_SET goes before the next chunk */
	zassert_equal(sent_count(CTAG_MESH_OP_ASSIGN_SET), 1u);
	zassert_equal(sent_count(CTAG_MESH_OP_LAYOUT_CHUNK), 0u);
	end_last(0);
	zassert_equal(sent_count(CTAG_MESH_OP_LAYOUT_CHUNK), 1u);
}

ZTEST(gw_delivery, test_failed_end_is_retried_three_times_then_timeout)
{
	const struct sent *first;

	zassert_equal(deliver_status(1u, BRIDGE_A, 502u, 200u), CTAG_STATUS_ACCEPTED);
	first = last_sent(CTAG_MESH_OP_LAYOUT_BEGIN);
	for (int i = 0; i < 3; i++) {
		end_last(-ETIMEDOUT);
		zassert_equal(sent_count(CTAG_MESH_OP_LAYOUT_BEGIN), (size_t)i + 2u);
		zassert_mem_equal(last_sent(CTAG_MESH_OP_LAYOUT_BEGIN)->data, first->data, first->len,
				  "the same message again");
	}
	end_last(-ETIMEDOUT);
	host_read();
	zassert_not_null(result_for(502u));
	zassert_equal(field_u(result_for(502u), CTAG_CBOR_KEY_STATUS), CTAG_STATUS_TIMEOUT);
	zassert_equal(core.c.mesh_send_retries, 3u);
	zassert_equal(core.c.mesh_send_failures, 1u);
}

ZTEST(gw_delivery, test_status_ok_then_bridge_result)
{
	struct ctag_cbor_field t[5] = {
		{.key = CTAG_CBOR_KEY_WAKE_MS},     {.key = CTAG_CBOR_KEY_MESH_MS},
		{.key = CTAG_CBOR_KEY_TRANSFER_MS}, {.key = CTAG_CBOR_KEY_REFRESH_MS},
		{.key = CTAG_CBOR_KEY_SUSPEND_MS},
	};
	struct ctag_cbor_field f[3] = {{.key = CTAG_CBOR_KEY_DIGEST},
				       {.key = CTAG_CBOR_KEY_TIMING},
				       {.key = CTAG_CBOR_KEY_BRIDGE}};
	const struct frame *e;
	uint16_t xfer;

	zassert_equal(deliver_status(1u, BRIDGE_A, 503u, 200u), CTAG_STATUS_ACCEPTED);
	xfer = drive_to_commit();
	now_ms += 1234;
	mesh_status(BRIDGE_A, xfer, CTAG_STATUS_OK, 0u);
	host_read();
	e = event(CTAG_SERIAL_MSG_EVT_STAGE, 0);
	zassert_not_null(e);
	zassert_equal(field_u(e, CTAG_CBOR_KEY_STAGE), CTAG_STAGE_BRIDGE_RECEIVED);
	zassert_equal(field_u(e, CTAG_CBOR_KEY_UPDATE_ID), 503u);
	zassert_is_null(result_for(503u), "the bridge reports the outcome");
	mesh_result(BRIDGE_A, 7u, 503u, CTAG_STATUS_OK);
	zassert_equal(last_sent(CTAG_MESH_OP_RESULT_ACK)->dst, BRIDGE_A);
	zassert_equal(ctag_get_le16(last_sent(CTAG_MESH_OP_RESULT_ACK)->data), 7u);
	host_read();
	e = result_for(503u);
	zassert_not_null(e);
	zassert_true(field_has(e, CTAG_CBOR_KEY_SEQ), "EVT_RESULT is retained");
	zassert_equal(field_u(e, CTAG_CBOR_KEY_STATUS), CTAG_STATUS_OK);
	zassert_equal(field_u(e, CTAG_CBOR_KEY_BATTERY_MV), 2900u);
	zassert_equal(field_u(e, CTAG_CBOR_KEY_TAG_ID), 0xCAFE0001u);
	decode(e, f, 3u);
	zassert_equal(f[0].v.str.len, 8u);
	zassert_equal(f[0].v.str.ptr[0], 9u);
	zassert_equal(f[2].v.u, BRIDGE_A);
	zassert_equal(ctag_cbor_decode(f[1].v.str.ptr, f[1].v.str.len, t, 5u), 0);
	zassert_equal(t[0].v.u, 11u);
	zassert_equal(t[1].v.u, 1234u, "mesh_ms: transfer start to LAYOUT_STATUS");
	zassert_equal(t[2].v.u, 33u);
	zassert_equal(t[3].v.u, 44u);
	zassert_equal(t[4].v.u, 22u);
	/* The bridge's flags and the tag's stored epoch, as reported. */
	zassert_equal(field_u(e, CTAG_CBOR_KEY_FLAGS), CTAG_RESULT_FLAG_DUPLICATE);
	zassert_equal(field_u(e, CTAG_CBOR_KEY_STORED_EPOCH), 3u);
}

/* EVT_RESULT with every field at its largest encoding still fits one
 * retained slot (CONFIG_CTAG_GW_EVENT_MAX): flags and stored_epoch included. */
ZTEST(gw_delivery, test_largest_result_is_retained)
{
	struct ctag_mesh_delivery_result r = {
		.result_seq = UINT16_MAX,
		.update_id = UINT64_MAX,
		.tag_id = UINT32_MAX,
		.epoch = UINT32_MAX,
		.revision = UINT32_MAX,
		.status = CTAG_STATUS_SUPERSEDED,
		.digest = {0xFF, 0xFF, 0xFF, 0xFF, 0xFF, 0xFF, 0xFF, 0xFF},
		.battery_mv = UINT16_MAX,
		.wake_ms = UINT16_MAX,
		.suspend_ms = UINT16_MAX,
		.transfer_ms = UINT16_MAX,
		.refresh_ms = UINT16_MAX,
		.stored_epoch = UINT32_MAX,
		.flags = CTAG_RESULT_FLAG_DUPLICATE | CTAG_RESULT_FLAG_ESCALATED,
	};
	const struct frame *e;

	core.s.seq = UINT32_MAX - 1u; /* the next seq takes 5 bytes */
	mesh_result_msg(0x7FFFu, &r);
	host_read();
	e = result_for(UINT64_MAX);
	zassert_not_null(e, "the largest EVT_RESULT was dropped");
	zassert_equal(core.c.internal_errors, 0u);
	/* 96 bytes: mesh_ms is 0 here (no transfer), 4 below the 100-byte worst case. */
	zassert_equal(e->len, 96u, "worst-case EVT_RESULT: %u bytes", (unsigned int)e->len);
	zassert_true(e->len + 4u <= CONFIG_CTAG_GW_EVENT_MAX);
	zassert_equal(field_u(e, CTAG_CBOR_KEY_STORED_EPOCH), UINT32_MAX);
	zassert_equal(field_u(e, CTAG_CBOR_KEY_FLAGS), 3u);
}

/* The gateway's own results (no tag session): flags 0 and stored epoch 0. */
ZTEST(gw_delivery, test_gateway_result_has_no_tag_report)
{
	uint16_t xfer;

	zassert_equal(deliver_status(2u, BRIDGE_A, 506u, 200u), CTAG_STATUS_ACCEPTED);
	xfer = drive_to_commit();
	mesh_status(BRIDGE_A, xfer, CTAG_STATUS_FONTPACK_MISMATCH, 0u);
	host_read();
	zassert_not_null(result_for(506u));
	zassert_equal(field_u(result_for(506u), CTAG_CBOR_KEY_STATUS), CTAG_STATUS_FONTPACK_MISMATCH);
	zassert_true(field_has(result_for(506u), CTAG_CBOR_KEY_FLAGS));
	zassert_equal(field_u(result_for(506u), CTAG_CBOR_KEY_FLAGS), 0u);
	zassert_equal(field_u(result_for(506u), CTAG_CBOR_KEY_STORED_EPOCH), 0u);
}

ZTEST(gw_delivery, test_results_are_deduplicated_by_bridge_and_seq)
{
	mesh_result(BRIDGE_A, 9u, 600u, CTAG_STATUS_OK);
	mesh_result(BRIDGE_A, 9u, 600u, CTAG_STATUS_OK); /* the bridge re-sent it */
	mesh_result(BRIDGE_B, 9u, 601u, CTAG_STATUS_OK); /* another bridge, same seq */
	host_read();
	zassert_equal(events_of(CTAG_SERIAL_MSG_EVT_RESULT), 2u);
	zassert_equal(sent_count(CTAG_MESH_OP_RESULT_ACK), 3u, "every copy is acknowledged");
	zassert_equal(core.c.duplicate_results, 1u);
}

ZTEST(gw_delivery, test_incomplete_resends_exactly_the_missing_chunks)
{
	uint16_t xfer;
	size_t chunks;

	zassert_equal(deliver_status(1u, BRIDGE_A, 504u, 700u), CTAG_STATUS_ACCEPTED); /* 5 chunks */
	xfer = drive_to_commit();
	chunks = sent_count(CTAG_MESH_OP_LAYOUT_CHUNK);
	zassert_equal(chunks, 5u);
	for (uint8_t round = 1; round <= GW_INCOMPLETE_ROUNDS; round++) {
		struct ctag_mesh_layout_chunk c = {0};
		const struct sent *s;

		mesh_status(BRIDGE_A, xfer, CTAG_STATUS_INCOMPLETE, (1u << 1) | (1u << 3) | (1u << 20));
		zassert_equal(drive_to_commit(), xfer);
		zassert_equal(sent_count(CTAG_MESH_OP_LAYOUT_CHUNK), chunks + 2u * round,
			      "bits beyond chunk_count are ignored");
		s = &mock.sent[mock.n_sent - 2u];
		zassert_equal(ctag_mesh_layout_chunk_unpack(&c, s->data, s->len), 0);
		zassert_equal(c.index, 3u);
	}
	mesh_status(BRIDGE_A, xfer, CTAG_STATUS_INCOMPLETE, 1u << 1);
	host_read();
	zassert_equal(field_u(result_for(504u), CTAG_CBOR_KEY_STATUS), CTAG_STATUS_INCOMPLETE);
	zassert_equal(core.c.chunks_resent, 6u);
}

ZTEST(gw_delivery, test_commit_resent_then_timeout)
{
	zassert_equal(deliver_status(1u, BRIDGE_A, 505u, 100u), CTAG_STATUS_ACCEPTED);
	(void)drive_to_commit();
	zassert_equal(sent_count(CTAG_MESH_OP_LAYOUT_COMMIT), 1u);
	for (int i = 1; i <= (int)GW_COMMIT_RESENDS; i++) {
		advance(CONFIG_CTAG_GW_STATUS_TIMEOUT_MS - 1);
		zassert_equal(sent_count(CTAG_MESH_OP_LAYOUT_COMMIT), (size_t)i);
		advance(1);
		zassert_equal(sent_count(CTAG_MESH_OP_LAYOUT_COMMIT), (size_t)i + 1u);
	}
	advance(CONFIG_CTAG_GW_STATUS_TIMEOUT_MS);
	host_read();
	zassert_equal(field_u(result_for(505u), CTAG_CBOR_KEY_STATUS), CTAG_STATUS_TIMEOUT);
	zassert_equal(core.c.commit_resends, 3u);
}

ZTEST(gw_delivery, test_rejection_becomes_the_result_with_zero_digest)
{
	static const uint8_t zero[8];
	struct ctag_cbor_field d = {.key = CTAG_CBOR_KEY_DIGEST};
	uint16_t xfer;

	zassert_equal(deliver_status(1u, BRIDGE_A, 506u, 100u), CTAG_STATUS_ACCEPTED);
	xfer = drive_to_commit();
	mesh_status(BRIDGE_A, xfer, CTAG_STATUS_DIGEST_MISMATCH, 0u);
	host_read();
	zassert_equal(field_u(result_for(506u), CTAG_CBOR_KEY_STATUS), CTAG_STATUS_DIGEST_MISMATCH);
	decode(result_for(506u), &d, 1u);
	zassert_equal(d.v.str.len, 8u);
	zassert_mem_equal(d.v.str.ptr, zero, 8u);
	zassert_equal(events_of(CTAG_SERIAL_MSG_EVT_STAGE), 0u);
}

ZTEST(gw_delivery, test_duplicate_status_waits_for_the_bridge_result)
{
	uint16_t xfer;

	zassert_equal(deliver_status(1u, BRIDGE_A, 507u, 100u), CTAG_STATUS_ACCEPTED);
	zassert_equal(deliver_status(2u, BRIDGE_A, 508u, 100u), CTAG_STATUS_ACCEPTED);
	xfer = drive_to_commit();
	zassert_equal(sent_count(CTAG_MESH_OP_LAYOUT_BEGIN), 1u, "one transfer at a time");
	mesh_status(BRIDGE_A, xfer, CTAG_STATUS_DUPLICATE, 0u);
	host_read();
	zassert_is_null(result_for(507u), "the bridge reports the outcome");
	zassert_equal(events_of(CTAG_SERIAL_MSG_EVT_STAGE), 1u, "DUPLICATE is OK (10)");
	zassert_equal(field_u(event(CTAG_SERIAL_MSG_EVT_STAGE, 0), CTAG_CBOR_KEY_STAGE),
		      CTAG_STAGE_BRIDGE_RECEIVED);
	zassert_equal(sent_count(CTAG_MESH_OP_LAYOUT_BEGIN), 2u, "the next transfer starts");
	mesh_status(BRIDGE_A, xfer, CTAG_STATUS_OK, 0u); /* stale xfer_id */
	zassert_equal(core.c.stale_status, 1u);
}

ZTEST(gw_delivery, test_lost_status_ok_recovered_by_the_recommit)
{
	struct ctag_cbor_field f[2] = {GW_F_UINT(CTAG_CBOR_KEY_OP_ID, 90u),
				       GW_F_UINT(CTAG_CBOR_KEY_UPDATE_ID, 509u)};
	uint16_t xfer;

	zassert_equal(deliver_status(1u, BRIDGE_A, 509u, 300u), CTAG_STATUS_ACCEPTED);
	xfer = drive_to_commit();
	/* The bridge validated the layout and answered OK; the answer was lost. */
	advance(CONFIG_CTAG_GW_STATUS_TIMEOUT_MS);
	zassert_equal(sent_count(CTAG_MESH_OP_LAYOUT_COMMIT), 2u, "the commit is re-sent");
	/* The bridge already holds that transfer: DUPLICATE, never NOT_FOUND. */
	mesh_status(BRIDGE_A, xfer, CTAG_STATUS_DUPLICATE, 0u);
	host_read();
	zassert_is_null(result_for(509u), "a lost status never ends the delivery");
	zassert_equal(events_of(CTAG_SERIAL_MSG_EVT_STAGE), 1u);
	/* It is at the bridge: a cancel still reaches it, and its result is the one. */
	zassert_equal(request_status(CTAG_SERIAL_MSG_CANCEL_DELIVERY, f, 2u), CTAG_STATUS_ACCEPTED);
	advance(3 * CONFIG_CTAG_GW_STATUS_TIMEOUT_MS);
	zassert_equal(sent_count(CTAG_MESH_OP_LAYOUT_COMMIT), 2u, "no more commits");
	mesh_result(BRIDGE_A, 3u, 509u, CTAG_STATUS_OK);
	host_read();
	zassert_not_null(result_for(509u));
	zassert_equal(field_u(result_for(509u), CTAG_CBOR_KEY_STATUS), CTAG_STATUS_OK);
	zassert_equal(events_of(CTAG_SERIAL_MSG_EVT_RESULT), 1u);
}

ZTEST(gw_delivery, test_result_while_waiting_for_the_status_ends_the_transfer)
{
	struct ctag_cbor_field t = {.key = CTAG_CBOR_KEY_MESH_MS};
	struct ctag_cbor_field f = {.key = CTAG_CBOR_KEY_TIMING};
	uint16_t xfer;

	zassert_equal(deliver_status(1u, BRIDGE_A, 510u, 200u), CTAG_STATUS_ACCEPTED);
	zassert_equal(deliver_status(2u, BRIDGE_A, 511u, 200u), CTAG_STATUS_ACCEPTED);
	xfer = drive_to_commit();
	now_ms += 700;
	/* LAYOUT_STATUS OK lost; the bridge already reports the outcome. */
	mesh_result(BRIDGE_A, 30u, 510u, CTAG_STATUS_OK);
	host_read();
	zassert_equal(field_u(result_for(510u), CTAG_CBOR_KEY_STATUS), CTAG_STATUS_OK);
	decode(result_for(510u), &f, 1u);
	zassert_equal(ctag_cbor_decode(f.v.str.ptr, f.v.str.len, &t, 1u), 0);
	zassert_equal(t.v.u, 700u);
	zassert_equal(sent_count(CTAG_MESH_OP_LAYOUT_BEGIN), 2u, "the next transfer starts at once");
	advance(CONFIG_CTAG_GW_STATUS_TIMEOUT_MS);
	zassert_equal(core.c.commit_resends, 0u, "no re-commit of the finished transfer");
	mesh_status(BRIDGE_A, xfer, CTAG_STATUS_OK, 0u); /* the late status is stale */
	zassert_equal(core.c.stale_status, 1u);
	host_read();
	zassert_equal(events_of(CTAG_SERIAL_MSG_EVT_RESULT), 0u);
}

ZTEST(gw_delivery, test_exactly_one_result_per_update_id)
{
	/* Two results from the bridge for one update_id (different result_seq). */
	mesh_result(BRIDGE_A, 20u, 1100u, CTAG_STATUS_SUPERSEDED);
	mesh_result(BRIDGE_A, 21u, 1100u, CTAG_STATUS_OK);
	host_read();
	zassert_equal(events_of(CTAG_SERIAL_MSG_EVT_RESULT), 1u);
	zassert_equal(field_u(result_for(1100u), CTAG_CBOR_KEY_STATUS), CTAG_STATUS_SUPERSEDED);
	zassert_equal(sent_count(CTAG_MESH_OP_RESULT_ACK), 2u, "both are acknowledged");
	zassert_equal(core.c.repeated_results, 1u);

	/* The gateway reported TIMEOUT; the bridge's late result is dropped. */
	zassert_equal(deliver_status(1u, BRIDGE_A, 1101u, 100u), CTAG_STATUS_ACCEPTED);
	(void)drive_to_commit();
	for (int i = 0; i < 1 + (int)GW_COMMIT_RESENDS; i++) {
		advance(CONFIG_CTAG_GW_STATUS_TIMEOUT_MS);
	}
	host_read();
	zassert_not_null(result_for(1101u));
	zassert_equal(field_u(result_for(1101u), CTAG_CBOR_KEY_STATUS), CTAG_STATUS_TIMEOUT);
	mesh_result(BRIDGE_A, 22u, 1101u, CTAG_STATUS_OK);
	host_read();
	zassert_equal(events_of(CTAG_SERIAL_MSG_EVT_RESULT), 0u);
	zassert_equal(last_sent(CTAG_MESH_OP_RESULT_ACK)->data[0], 22u);
	zassert_equal(counter("repeated_results"), 2u);
}

ZTEST(gw_delivery, test_queue_full_answers_busy_and_is_not_remembered)
{
	uint16_t rid;

	zassert_equal(deliver_status(1u, BRIDGE_A, 1u, 100u), CTAG_STATUS_ACCEPTED); /* active */
	for (uint32_t i = 0; i < CONFIG_CTAG_GW_DELIVERY_QUEUE; i++) {
		zassert_equal(deliver_status(10u + i, BRIDGE_A, 10u + i, 100u), CTAG_STATUS_ACCEPTED);
	}
	zassert_equal(deliver_status(99u, BRIDGE_A, 99u, 100u), CTAG_STATUS_BUSY);
	zassert_equal(counter("queue_depth"), CONFIG_CTAG_GW_DELIVERY_QUEUE);
	/* The active one ends; the retry with the same op_id is accepted. */
	mesh_status(BRIDGE_A, drive_to_commit(), CTAG_STATUS_OK, 0u);
	rid = send_deliver(99u, BRIDGE_A, 99u, layout, 100u);
	host_read();
	zassert_equal(field_u(response(rid), CTAG_CBOR_KEY_STATUS), CTAG_STATUS_ACCEPTED);
	zassert_false(field_has(response(rid), CTAG_CBOR_KEY_DETAIL));
}

ZTEST(gw_delivery, test_layout_arena_full_answers_busy)
{
	/* 8 KiB arena: two full-size layouts, then only small ones fit. */
	zassert_equal(deliver_status(1u, BRIDGE_A, 1201u, 4000u), CTAG_STATUS_ACCEPTED);
	zassert_equal(deliver_status(2u, BRIDGE_A, 1202u, 4000u), CTAG_STATUS_ACCEPTED);
	zassert_equal(deliver_status(3u, BRIDGE_A, 1203u, 4000u), CTAG_STATUS_BUSY);
	zassert_equal(deliver_status(4u, BRIDGE_A, 1204u, 100u), CTAG_STATUS_ACCEPTED);
	/* The first transfer ends: its bytes are free again, in order. */
	mesh_status(BRIDGE_A, drive_to_commit(), CTAG_STATUS_OK, 0u);
	zassert_equal(deliver_status(3u, BRIDGE_A, 1203u, 4000u), CTAG_STATUS_ACCEPTED);
	zassert_true(counter("layout_arena_used") > 8000u);
}

ZTEST(gw_delivery, test_unknown_or_unconfigured_bridge_is_not_found)
{
	zassert_equal(deliver_status(1u, 0x0009u, 1u, 100u), CTAG_STATUS_NOT_FOUND);
	zassert_equal(deliver_status(2u, BRIDGE_B, 2u, 100u), CTAG_STATUS_NOT_FOUND);
	zassert_equal(mock.n_sent, 0u);
}

ZTEST(gw_delivery, test_empty_and_oversized_layouts_are_refused)
{
	zassert_equal(deliver_status(1u, BRIDGE_A, 1u, 0u), CTAG_STATUS_INVALID);
	zassert_equal(deliver_status(2u, BRIDGE_A, 2u, CONFIG_CTAG_GW_LAYOUT_MAX + 1u),
		      CTAG_STATUS_TOO_LARGE);
	zassert_equal(deliver_status(3u, BRIDGE_A, 3u, CONFIG_CTAG_GW_LAYOUT_MAX),
		      CTAG_STATUS_ACCEPTED);
}

ZTEST(gw_delivery, test_cancel_queued_in_flight_and_unknown)
{
	struct ctag_cbor_field f[2] = {GW_F_UINT(CTAG_CBOR_KEY_OP_ID, 0u),
				       GW_F_UINT(CTAG_CBOR_KEY_UPDATE_ID, 0u)};

	zassert_equal(deliver_status(1u, BRIDGE_A, 701u, 100u), CTAG_STATUS_ACCEPTED);
	zassert_equal(deliver_status(2u, BRIDGE_A, 702u, 100u), CTAG_STATUS_ACCEPTED);
	f[0].v.u = 50u;
	f[1].v.u = 702u; /* queued: dropped here, CANCELLED result */
	zassert_equal(request_status(CTAG_SERIAL_MSG_CANCEL_DELIVERY, f, 2u), CTAG_STATUS_OK);
	host_read();
	zassert_equal(counter("queue_depth"), 0u);
	f[0].v.u = 51u;
	f[1].v.u = 701u; /* in transfer: LAYOUT_CANCEL to the bridge */
	zassert_equal(request_status(CTAG_SERIAL_MSG_CANCEL_DELIVERY, f, 2u), CTAG_STATUS_ACCEPTED);
	zassert_equal(last_sent(CTAG_MESH_OP_LAYOUT_CANCEL)->dst, BRIDGE_A);
	zassert_equal(ctag_get_le64(last_sent(CTAG_MESH_OP_LAYOUT_CANCEL)->data), 701u);
	f[0].v.u = 52u;
	f[1].v.u = 703u;
	zassert_equal(request_status(CTAG_SERIAL_MSG_CANCEL_DELIVERY, f, 2u), CTAG_STATUS_NOT_FOUND);
	/* The CANCELLED result of 702 was emitted (and is retained). */
	core_session();
	zassert_equal(field_u(result_for(702u), CTAG_CBOR_KEY_STATUS), CTAG_STATUS_CANCELLED);
}

ZTEST(gw_delivery, test_cancel_reaches_a_layout_at_the_bridge)
{
	struct ctag_cbor_field f[2] = {GW_F_UINT(CTAG_CBOR_KEY_OP_ID, 60u),
				       GW_F_UINT(CTAG_CBOR_KEY_UPDATE_ID, 801u)};

	zassert_equal(deliver_status(1u, BRIDGE_A, 801u, 100u), CTAG_STATUS_ACCEPTED);
	mesh_status(BRIDGE_A, drive_to_commit(), CTAG_STATUS_OK, 0u);
	zassert_equal(request_status(CTAG_SERIAL_MSG_CANCEL_DELIVERY, f, 2u), CTAG_STATUS_ACCEPTED);
	zassert_equal(sent_count(CTAG_MESH_OP_LAYOUT_CANCEL), 1u);
}

ZTEST(gw_delivery, test_no_buffer_is_not_a_failed_send)
{
	mock.send_rc[0] = -ENOBUFS;
	mock.send_rc_n = 1u;
	zassert_equal(deliver_status(1u, BRIDGE_A, 901u, 100u), CTAG_STATUS_ACCEPTED);
	zassert_equal(sent_count(CTAG_MESH_OP_LAYOUT_BEGIN), 0u);
	advance(GW_RETRY_MS);
	zassert_equal(sent_count(CTAG_MESH_OP_LAYOUT_BEGIN), 1u);
	zassert_equal(core.c.mesh_send_retries, 0u);
	zassert_equal(core.c.mesh_busy, 1u);
}

ZTEST(gw_delivery, test_deliveries_run_in_acceptance_order)
{
	struct ctag_mesh_layout_begin b;

	zassert_equal(deliver_status(1u, BRIDGE_A, 1001u, 100u), CTAG_STATUS_ACCEPTED);
	zassert_equal(deliver_status(2u, BRIDGE_A, 1002u, 100u), CTAG_STATUS_ACCEPTED);
	zassert_equal(deliver_status(3u, BRIDGE_A, 1003u, 100u), CTAG_STATUS_ACCEPTED);
	for (uint64_t u = 1001u; u <= 1003u; u++) {
		const struct sent *s = last_sent(CTAG_MESH_OP_LAYOUT_BEGIN);
		uint16_t xfer;

		zassert_equal(ctag_mesh_layout_begin_unpack(&b, s->data, s->len), 0);
		zassert_equal(b.update_id, u);
		xfer = drive_to_commit();
		zassert_equal(xfer, b.xfer_id);
		mesh_status(BRIDGE_A, xfer, CTAG_STATUS_OK, 0u);
	}
	host_read();
	zassert_equal(events_of(CTAG_SERIAL_MSG_EVT_STAGE), 3u);
}
```

## src/test_nodes.c
```c
/* Provisioning, configuration, removal, assignments, tag commands, scanning,
 * TAG_SEEN and the inventory (2, 10). */
#include <string.h>

#include "common.h"

static const uint8_t new_uuid[16] = {0xC0, 0xFF, 0xEE, 3, 4, 5, 6, 7, 8, 9, 10, 11, 12, 13, 14, 15};

static void before(void *f)
{
	(void)f;
	core_reset();
	core_session();
}

ZTEST_SUITE(gw_nodes, NULL, NULL, before, NULL, NULL);

static uint16_t provision(uint64_t op_id, const uint8_t *uuid, const char *name)
{
	static const uint8_t oob[32] = {0x0B, 0x0B};
	struct ctag_cbor_field f[4] = {
		GW_F_UINT(CTAG_CBOR_KEY_OP_ID, op_id),
		GW_F_BSTR(CTAG_CBOR_KEY_UUID, uuid, 16u),
		/* v2: static_oob is required */
		GW_F_BSTR(CTAG_CBOR_KEY_STATIC_OOB, oob, sizeof(oob)),
		GW_F_TSTR(CTAG_CBOR_KEY_NAME, name, name != NULL ? strlen(name) : 0u),
	};
	size_t n = IS_ENABLED(CONFIG_CTAG_GW_SECURE) ? 3u : 2u;

	if (!IS_ENABLED(CONFIG_CTAG_GW_SECURE)) {
		f[2] = f[3];
	}
	if (name != NULL) {
		f[n] = f[3];
		n++;
	}
	return host_send(CTAG_SERIAL_MSG_PROVISION, f, n, 1u);
}

static uint8_t status_of(uint16_t rid)
{
	host_read();
	zassert_not_null(response(rid));
	return (uint8_t)field_u(response(rid), CTAG_CBOR_KEY_STATUS);
}

static uint16_t configure(uint64_t op_id, uint16_t addr, bool relay, uint32_t ttl)
{
	struct ctag_cbor_field f[4] = {
		GW_F_UINT(CTAG_CBOR_KEY_OP_ID, op_id), GW_F_UINT(CTAG_CBOR_KEY_ADDR, addr),
		GW_F_BOOL(CTAG_CBOR_KEY_RELAY, relay), GW_F_UINT(CTAG_CBOR_KEY_TTL, ttl),
	};

	return host_send(CTAG_SERIAL_MSG_CONFIGURE_NODE, f, 4u, 1u);
}

static uint16_t op_addr(uint8_t type, uint64_t op_id, uint16_t addr)
{
	struct ctag_cbor_field f[2] = {GW_F_UINT(CTAG_CBOR_KEY_OP_ID, op_id),
				       GW_F_UINT(CTAG_CBOR_KEY_ADDR, addr)};

	return host_send(type, f, 2u, 1u);
}

static uint16_t assign(uint8_t type, uint64_t op_id, uint16_t bridge, uint32_t tag, uint32_t epoch)
{
	static const uint8_t key[16] = {0x11, 0x22};
	struct ctag_cbor_field f[5] = {
		GW_F_UINT(CTAG_CBOR_KEY_OP_ID, op_id), GW_F_UINT(CTAG_CBOR_KEY_BRIDGE, bridge),
		GW_F_UINT(CTAG_CBOR_KEY_TAG_ID, tag),  GW_F_UINT(CTAG_CBOR_KEY_EPOCH, epoch),
		GW_F_BSTR(CTAG_CBOR_KEY_KEY, key, 16u),
	};

	return host_send(type, f, type == CTAG_SERIAL_MSG_ASSIGN_TAG ? 5u : 4u, 1u);
}

ZTEST(gw_nodes, test_provision_adds_the_node_and_reports_it)
{
	struct ctag_cbor_field f[5] = {{.key = CTAG_CBOR_KEY_OP_ID}, {.key = CTAG_CBOR_KEY_UUID},
				       {.key = CTAG_CBOR_KEY_ADDR},  {.key = CTAG_CBOR_KEY_ELEMENTS},
				       {.key = CTAG_CBOR_KEY_STATUS}};
	const struct frame *e;

	zassert_equal(status_of(provision(11u, new_uuid, "kitchen")), CTAG_STATUS_ACCEPTED);
	zassert_equal(mock.n_provision, 1u);
	zassert_mem_equal(mock.provisioned[0], new_uuid, 16u);
	/* A second provisioning while one runs: transient, not remembered. */
	zassert_equal(status_of(provision(12u, new_uuid, NULL)), CTAG_STATUS_PROVISIONING_ACTIVE);
	gw_core_prov_link_open(&core, now_ms);
	gw_core_prov_added(&core, new_uuid, 0x0004u, 1u, now_ms);
	gw_core_prov_closed(&core, now_ms);
	host_read();
	e = event(CTAG_SERIAL_MSG_EVT_PROVISIONED, 0);
	zassert_not_null(e);
	decode(e, f, 5u);
	zassert_equal(f[0].v.u, 11u);
	zassert_mem_equal(f[1].v.str.ptr, new_uuid, 16u);
	zassert_equal(f[2].v.u, 0x0004u);
	zassert_equal(f[3].v.u, 1u);
	zassert_equal(f[4].v.u, CTAG_STATUS_OK);
	zassert_true(field_has(e, CTAG_CBOR_KEY_SEQ));
	zassert_equal(mock.stored_name_len, 7u);
	zassert_mem_equal(mock.stored_name, "kitchen", 7u);
	zassert_equal(counter("nodes"), 3u);
	/* The retry of the refused request now reports the node where it lives. */
	zassert_equal(status_of(provision(12u, new_uuid, NULL)), CTAG_STATUS_ACCEPTED);
	host_read();
	zassert_equal(mock.n_provision, 1u, "known UUID: no new provisioning");
}

ZTEST(gw_nodes, test_provision_of_an_absent_device_fails)
{
	const struct frame *e;

	zassert_equal(status_of(provision(13u, new_uuid, NULL)), CTAG_STATUS_ACCEPTED);
	gw_core_prov_closed(&core, now_ms); /* the link never opened */
	host_read();
	e = event(CTAG_SERIAL_MSG_EVT_PROVISIONED, 0);
	zassert_equal(field_u(e, CTAG_CBOR_KEY_STATUS), CTAG_STATUS_NOT_FOUND);
	zassert_equal(field_u(e, CTAG_CBOR_KEY_ADDR), 0u);
	/* A link that opened but never completed times out. */
	zassert_equal(status_of(provision(14u, new_uuid, NULL)), CTAG_STATUS_ACCEPTED);
	gw_core_prov_link_open(&core, now_ms);
	advance(CONFIG_CTAG_GW_PROVISION_TIMEOUT_MS);
	host_read();
	zassert_equal(field_u(event(CTAG_SERIAL_MSG_EVT_PROVISIONED, 0), CTAG_CBOR_KEY_STATUS),
		      CTAG_STATUS_TIMEOUT);
}

ZTEST(gw_nodes, test_provision_refuses_beyond_max_bridges)
{
	uint8_t u[16] = {0x55};

	for (uint16_t a = 4; a < 4 + CTAG_MAX_BRIDGES - 2; a++) {
		u[1] = (uint8_t)a;
		gw_core_add_node(&core, a, u, 1u, true);
	}
	zassert_equal(status_of(provision(15u, new_uuid, NULL)), CTAG_STATUS_NO_RESOURCES);
	zassert_equal(mock.n_provision, 0u);
}

ZTEST(gw_nodes, test_configure_runs_every_step_in_order)
{
	static const uint8_t order[] = {GW_CFG_APP_KEY_ADD, GW_CFG_BIND_LAYOUT, GW_CFG_BIND_MGMT,
					GW_CFG_RELAY,       GW_CFG_TTL,         GW_CFG_NET_TX};
	const struct frame *e;

	zassert_equal(status_of(configure(21u, BRIDGE_B, true, 5u)), CTAG_STATUS_ACCEPTED);
	zassert_equal(mock.n_cfg, 1u);
	zassert_not_equal(mock.cfg[0].tag, 0u, "AppKey Add is segmented: through the lane");
	for (size_t i = 0; i < ARRAY_SIZE(order); i++) {
		const struct cfg_call *c = &mock.cfg[i];

		zassert_equal(mock.n_cfg, i + 1u);
		zassert_equal(c->step, order[i]);
		zassert_equal(c->addr, BRIDGE_B);
		if (c->step == GW_CFG_RELAY) {
			zassert_equal(c->arg, 1u);
		}
		if (c->step == GW_CFG_TTL) {
			zassert_equal(c->arg, 5u);
		}
		if (c->tag != 0u) {
			end_tag(c->tag, 0);
		}
		gw_core_cfg_status(&core, BRIDGE_B, c->step, 0u,
				   c->step == GW_CFG_RELAY ? 1u : c->step == GW_CFG_TTL ? 5u : 0u,
				   now_ms);
	}
	host_read();
	e = event(CTAG_SERIAL_MSG_EVT_NODE_CONFIGURED, 0);
	zassert_not_null(e);
	zassert_equal(field_u(e, CTAG_CBOR_KEY_STATUS), CTAG_STATUS_OK);
	zassert_equal(field_u(e, CTAG_CBOR_KEY_OP_ID), 21u);
	zassert_equal(mock.n_configured, 1u);
	zassert_equal(mock.configured[0], BRIDGE_B);
	zassert_true(core.nodes[1].configured);
	zassert_equal(last_sent(CTAG_MESH_OP_CAPS_GET)->dst, BRIDGE_B, "then its inventory");
	zassert_equal(last_sent(CTAG_MESH_OP_HEALTH_GET)->dst, BRIDGE_B);
}

ZTEST(gw_nodes, test_configure_status_before_the_segment_ack)
{
	zassert_equal(status_of(configure(22u, BRIDGE_B, true, 5u)), CTAG_STATUS_ACCEPTED);
	/* AppKey Status arrives before the lower transport's end callback. */
	gw_core_cfg_status(&core, BRIDGE_B, GW_CFG_APP_KEY_ADD, 0u, 0u, now_ms);
	zassert_equal(mock.n_cfg, 2u);
	zassert_equal(mock.cfg[1].step, GW_CFG_BIND_LAYOUT);
	end_tag(mock.cfg[0].tag, 0); /* late: ignored */
	zassert_equal(mock.n_cfg, 2u);
}

ZTEST(gw_nodes, test_configure_times_out_after_three_attempts)
{
	zassert_equal(status_of(configure(23u, BRIDGE_B, true, 5u)), CTAG_STATUS_ACCEPTED);
	end_tag(mock.cfg[0].tag, 0);
	gw_core_cfg_status(&core, BRIDGE_B, GW_CFG_APP_KEY_ADD, 0u, 0u, now_ms);
	for (int i = 0; i < (int)GW_CFG_ATTEMPTS; i++) {
		zassert_equal(mock.n_cfg, 2u + (size_t)i);
		advance(CONFIG_CTAG_GW_REPLY_TIMEOUT_MS);
	}
	host_read();
	zassert_equal(field_u(event(CTAG_SERIAL_MSG_EVT_NODE_CONFIGURED, 0), CTAG_CBOR_KEY_STATUS),
		      CTAG_STATUS_TIMEOUT);
	zassert_false(core.nodes[1].configured);
}

ZTEST(gw_nodes, test_configure_refusals)
{
	zassert_equal(status_of(configure(24u, 0x0042u, true, 5u)), CTAG_STATUS_NOT_FOUND);
	zassert_equal(status_of(configure(25u, BRIDGE_B, true, 1u)), CTAG_STATUS_INVALID);
	zassert_equal(status_of(provision(26u, new_uuid, NULL)), CTAG_STATUS_ACCEPTED);
	zassert_equal(status_of(configure(27u, BRIDGE_B, true, 5u)),
		      CTAG_STATUS_PROVISIONING_ACTIVE);
	zassert_equal(status_of(op_addr(CTAG_SERIAL_MSG_REMOVE_NODE, 28u, BRIDGE_B)),
		      CTAG_STATUS_PROVISIONING_ACTIVE);
}

ZTEST(gw_nodes, test_configure_reports_a_missing_vendor_model)
{
	zassert_equal(status_of(configure(29u, BRIDGE_B, true, 5u)), CTAG_STATUS_ACCEPTED);
	end_tag(mock.cfg[0].tag, 0);
	gw_core_cfg_status(&core, BRIDGE_B, GW_CFG_APP_KEY_ADD, 0u, 0u, now_ms);
	gw_core_cfg_status(&core, BRIDGE_B, GW_CFG_BIND_LAYOUT, 0x02u, 0u, now_ms);
	host_read();
	zassert_equal(field_u(event(CTAG_SERIAL_MSG_EVT_NODE_CONFIGURED, 0), CTAG_CBOR_KEY_STATUS),
		      CTAG_STATUS_UNSUPPORTED);
}

ZTEST(gw_nodes, test_remove_resets_and_deletes)
{
	const struct frame *e;

	zassert_equal(status_of(assign(CTAG_SERIAL_MSG_ASSIGN_TAG, 30u, BRIDGE_A, 77u, 2u)),
		      CTAG_STATUS_ACCEPTED);
	end_last(0);
	mesh_assign_status(BRIDGE_A, 77u, 2u, CTAG_STATUS_OK);
	zassert_equal(core.assign_count, 1u);
	zassert_equal(status_of(op_addr(CTAG_SERIAL_MSG_REMOVE_NODE, 31u, BRIDGE_A)),
		      CTAG_STATUS_ACCEPTED);
	zassert_equal(mock.cfg[mock.n_cfg - 1u].step, GW_CFG_RESET);
	gw_core_cfg_status(&core, BRIDGE_A, GW_CFG_RESET, 0u, 0u, now_ms);
	host_read();
	e = event(CTAG_SERIAL_MSG_EVT_NODE_REMOVED, 0);
	zassert_not_null(e);
	zassert_equal(field_u(e, CTAG_CBOR_KEY_STATUS), CTAG_STATUS_OK);
	zassert_equal(field_u(e, CTAG_CBOR_KEY_ADDR), BRIDGE_A);
	zassert_equal(mock.n_deleted, 1u);
	zassert_is_null(gw_node_get(&core, BRIDGE_A));
	zassert_equal(core.assign_count, 0u, "its assignments go with it");
	zassert_equal(status_of(op_addr(CTAG_SERIAL_MSG_REMOVE_NODE, 32u, BRIDGE_A)),
		      CTAG_STATUS_NOT_FOUND);
}

ZTEST(gw_nodes, test_remove_of_a_silent_node_still_deletes_it)
{
	zassert_equal(status_of(op_addr(CTAG_SERIAL_MSG_REMOVE_NODE, 33u, BRIDGE_B)),
		      CTAG_STATUS_ACCEPTED);
	for (int i = 0; i < (int)GW_CFG_ATTEMPTS; i++) {
		advance(CONFIG_CTAG_GW_REPLY_TIMEOUT_MS);
	}
	host_read();
	zassert_equal(field_u(event(CTAG_SERIAL_MSG_EVT_NODE_REMOVED, 0), CTAG_CBOR_KEY_STATUS),
		      CTAG_STATUS_OK);
	zassert_equal(mock.n_cfg, GW_CFG_ATTEMPTS);
	zassert_is_null(gw_node_get(&core, BRIDGE_B));
}

ZTEST(gw_nodes, test_assign_and_unassign)
{
	struct ctag_mesh_assign_set m;
	const struct frame *e;

	zassert_equal(status_of(assign(CTAG_SERIAL_MSG_ASSIGN_TAG, 40u, BRIDGE_A, 5u, 3u)),
		      CTAG_STATUS_ACCEPTED);
	zassert_equal(ctag_mesh_assign_set_unpack(&m, last_sent(CTAG_MESH_OP_ASSIGN_SET)->data,
						  CTAG_MESH_ASSIGN_SET_LEN),
		      0);
	zassert_equal(m.tag_id, 5u);
	zassert_equal(m.epoch, 3u);
	zassert_equal(m.key[0], 0x11u);
	zassert_equal(m.flags, 1u);
	end_last(0);
	mesh_assign_status(BRIDGE_A, 5u, 3u, CTAG_STATUS_OK);
	host_read();
	e = event(CTAG_SERIAL_MSG_EVT_ASSIGN_RESULT, 0);
	zassert_equal(field_u(e, CTAG_CBOR_KEY_OP_ID), 40u);
	zassert_equal(field_u(e, CTAG_CBOR_KEY_STATUS), CTAG_STATUS_OK);
	zassert_equal(mock.stored_assign_n, 1u);
	zassert_equal(mock.stored_assign[0].epoch, 3u);
	/* UNASSIGN: ASSIGN_DEL is unsegmented. */
	zassert_equal(status_of(assign(CTAG_SERIAL_MSG_UNASSIGN_TAG, 41u, BRIDGE_A, 5u, 3u)),
		      CTAG_STATUS_ACCEPTED);
	zassert_equal(last_sent(CTAG_MESH_OP_ASSIGN_DEL)->tag, 0u);
	mesh_assign_status(BRIDGE_A, 5u, 3u, CTAG_STATUS_OK);
	zassert_equal(mock.stored_assign_n, 0u);
}

ZTEST(gw_nodes, test_assign_retries_then_times_out)
{
	zassert_equal(status_of(assign(CTAG_SERIAL_MSG_ASSIGN_TAG, 42u, BRIDGE_A, 6u, 1u)),
		      CTAG_STATUS_ACCEPTED);
	for (int i = 1; i <= (int)GW_REPLY_ATTEMPTS; i++) {
		zassert_equal(sent_count(CTAG_MESH_OP_ASSIGN_SET), (size_t)i);
		end_last(0);
		advance(CONFIG_CTAG_GW_REPLY_TIMEOUT_MS);
	}
	host_read();
	zassert_equal(field_u(event(CTAG_SERIAL_MSG_EVT_ASSIGN_RESULT, 0), CTAG_CBOR_KEY_STATUS),
		      CTAG_STATUS_TIMEOUT);
	zassert_equal(sent_count(CTAG_MESH_OP_ASSIGN_SET), GW_REPLY_ATTEMPTS);
}

ZTEST(gw_nodes, test_tag_command_send_failure_is_a_result)
{
	struct ctag_cbor_field f[5] = {
		GW_F_UINT(CTAG_CBOR_KEY_OP_ID, 4711u), GW_F_UINT(CTAG_CBOR_KEY_BRIDGE, BRIDGE_A),
		GW_F_UINT(CTAG_CBOR_KEY_TAG_ID, 8u),   GW_F_UINT(CTAG_CBOR_KEY_EPOCH, 2u),
		GW_F_UINT(CTAG_CBOR_KEY_CMD, CTAG_TAG_CMD_CLEAR),
	};
	struct ctag_mesh_tag_cmd m;

	zassert_equal(request_status(CTAG_SERIAL_MSG_TAG_COMMAND, f, 5u), CTAG_STATUS_ACCEPTED);
	zassert_equal(ctag_mesh_tag_cmd_unpack(&m, last_sent(CTAG_MESH_OP_TAG_CMD)->data,
					       CTAG_MESH_TAG_CMD_LEN),
		      0);
	zassert_equal(m.update_id, 4711u, "results come back under update_id = op_id");
	zassert_equal(m.cmd, CTAG_TAG_CMD_CLEAR);
	for (int i = 0; i <= (int)GW_SEND_RETRIES; i++) {
		end_last(-ETIMEDOUT);
	}
	host_read();
	zassert_equal(field_u(event(CTAG_SERIAL_MSG_EVT_RESULT, 0), CTAG_CBOR_KEY_UPDATE_ID), 4711u);
	zassert_equal(field_u(event(CTAG_SERIAL_MSG_EVT_RESULT, 0), CTAG_CBOR_KEY_STATUS),
		      CTAG_STATUS_TIMEOUT);
}

ZTEST(gw_nodes, test_mesh_ops_need_a_configured_bridge)
{
	zassert_equal(status_of(assign(CTAG_SERIAL_MSG_ASSIGN_TAG, 43u, BRIDGE_B, 6u, 1u)),
		      CTAG_STATUS_NOT_FOUND);
	zassert_equal(status_of(op_addr(CTAG_SERIAL_MSG_IDENTIFY_NODE, 44u, BRIDGE_B)),
		      CTAG_STATUS_NOT_FOUND);
	zassert_equal(status_of(op_addr(CTAG_SERIAL_MSG_IDENTIFY_NODE, 45u, BRIDGE_A)),
		      CTAG_STATUS_OK);
	zassert_equal(last_sent(CTAG_MESH_OP_IDENTIFY)->data[0], GW_IDENTIFY_S);
}

ZTEST(gw_nodes, test_scan_reports_each_matching_device_once)
{
	static const uint8_t prefix[2] = {0xC0, 0xFF};
	uint8_t other[16] = {0xD0};
	struct ctag_cbor_field f[2] = {GW_F_UINT(CTAG_CBOR_KEY_DURATION_S, 10u),
				       GW_F_BSTR(CTAG_CBOR_KEY_UUID_FILTER, prefix, 2u)};

	gw_core_beacon(&core, new_uuid, 0x0020u, -50, now_ms); /* not scanning yet */
	zassert_equal(request_status(CTAG_SERIAL_MSG_SCAN_UNPROV, f, 2u), CTAG_STATUS_OK);
	gw_core_beacon(&core, new_uuid, 0x0020u, -50, now_ms);
	gw_core_beacon(&core, new_uuid, 0x0020u, -40, now_ms); /* again */
	gw_core_beacon(&core, other, 0u, -60, now_ms);         /* filtered out */
	host_read();
	zassert_equal(events_of(CTAG_SERIAL_MSG_EVT_UNPROV_BEACON), 1u);
	zassert_equal((int64_t)field_u(event(CTAG_SERIAL_MSG_EVT_UNPROV_BEACON, 0), CTAG_CBOR_KEY_RSSI),
		      -50);
	zassert_equal(field_u(event(CTAG_SERIAL_MSG_EVT_UNPROV_BEACON, 0), CTAG_CBOR_KEY_OOB),
		      0x0020u);
	now_ms += 10000;
	gw_core_beacon(&core, (const uint8_t[16]){0xC0, 0xFF, 1}, 0u, -50, now_ms);
	host_read();
	zassert_equal(events_of(CTAG_SERIAL_MSG_EVT_UNPROV_BEACON), 0u, "the scan ended");
}

ZTEST(gw_nodes, test_tag_seen_is_rate_limited)
{
	struct ctag_mesh_tag_seen ts = {.tag_id = 0x77u, .rssi = -61, .battery_mv = 2800u};
	uint8_t p[CTAG_MESH_TAG_SEEN_LEN];

	(void)ctag_mesh_tag_seen_pack(&ts, p, sizeof(p));
	gw_core_mesh_rx(&core, BRIDGE_A, CTAG_MESH_OP_TAG_SEEN, p, sizeof(p), now_ms);
	now_ms += CONFIG_CTAG_GW_TAG_SEEN_INTERVAL_MS - 1;
	gw_core_mesh_rx(&core, BRIDGE_A, CTAG_MESH_OP_TAG_SEEN, p, sizeof(p), now_ms);
	host_read();
	zassert_equal(events_of(CTAG_SERIAL_MSG_EVT_TAG_SEEN), 1u);
	zassert_equal((int64_t)field_u(event(CTAG_SERIAL_MSG_EVT_TAG_SEEN, 0), CTAG_CBOR_KEY_RSSI), -61);
	zassert_equal(field_u(event(CTAG_SERIAL_MSG_EVT_TAG_SEEN, 0), CTAG_CBOR_KEY_BRIDGE), BRIDGE_A);
	now_ms += 1;
	gw_core_mesh_rx(&core, BRIDGE_A, CTAG_MESH_OP_TAG_SEEN, p, sizeof(p), now_ms);
	host_read();
	zassert_equal(events_of(CTAG_SERIAL_MSG_EVT_TAG_SEEN), 1u);
	zassert_equal(core.c.tag_seen_limited, 1u);
}

ZTEST(gw_nodes, test_list_nodes_and_inventory)
{
	struct ctag_mesh_caps_status caps = {.proto = 1u, .fw_major = 1u, .fw_minor = 2u,
					     .fw_patch = 13u, .board = 3u, .fontpack_id = {7},
					     .flash_mib = 8u, .max_tags = 20u, .assigned = 7u,
					     .flags = 1u};
	struct ctag_mesh_health_status health = {.uptime_s = 99u, .sessions_ok = 4u};
	uint8_t p[CTAG_MESH_CAPS_STATUS_LEN];
	struct ctag_cbor_field f = {.key = CTAG_CBOR_KEY_NODES};
	struct ctag_cbor_str items[8];
	struct ctag_cbor_field it[6] = {{.key = CTAG_CBOR_KEY_ADDR}, {.key = CTAG_CBOR_KEY_NAME},
					{.key = CTAG_CBOR_KEY_CONFIGURED}, {.key = CTAG_CBOR_KEY_FW},
					{.key = CTAG_CBOR_KEY_FLASH_SIZE},
					{.key = CTAG_CBOR_KEY_ASSIGNED}};
	uint16_t rid;
	const struct frame *e;

	rid = host_send(CTAG_SERIAL_MSG_LIST_NODES, NULL, 0u, 1u);
	host_read();
	decode(response(rid), &f, 1u);
	zassert_equal(ctag_cbor_maps(&f.v.str, items, 8u), 2, "the gateway itself is not listed");
	zassert_equal(ctag_cbor_decode(items[0].ptr, items[0].len, it, 3u), 0);
	zassert_equal(it[0].v.u, BRIDGE_A);
	zassert_mem_equal(it[1].v.str.ptr, "hall", 4u);
	zassert_true(it[2].v.b);

	(void)ctag_mesh_caps_status_pack(&caps, p, sizeof(p));
	gw_core_mesh_rx(&core, BRIDGE_A, CTAG_MESH_OP_CAPS_STATUS, p, CTAG_MESH_CAPS_STATUS_LEN,
			now_ms);
	(void)ctag_mesh_health_status_pack(&health, p, sizeof(p));
	gw_core_mesh_rx(&core, BRIDGE_A, CTAG_MESH_OP_HEALTH_STATUS, p, CTAG_MESH_HEALTH_STATUS_LEN,
			now_ms);
	host_read();
	zassert_equal(events_of(CTAG_SERIAL_MSG_EVT_BRIDGE_INFO), 2u);
	e = event(CTAG_SERIAL_MSG_EVT_BRIDGE_INFO, 1);
	zassert_equal(field_u(e, CTAG_CBOR_KEY_ADDR), BRIDGE_A);
	zassert_true(field_has(e, CTAG_CBOR_KEY_COUNTERS));
	{
		/* The bridge's capacity and its own count of assigned tags (CAPS_STATUS),
		 * whatever the gateway's assignment table holds (nothing yet). */
		struct ctag_cbor_field ev[2] = {{.key = CTAG_CBOR_KEY_CAPS},
						{.key = CTAG_CBOR_KEY_ASSIGNED}};
		struct ctag_cbor_field c[2] = {{.key = CTAG_CBOR_KEY_MAX_TAGS},
					       {.key = CTAG_CBOR_KEY_ASSIGNED_COUNT}};
		struct ctag_cbor_str none[1];

		decode(e, ev, 2u);
		zassert_true(ev[0].present && ev[1].present);
		zassert_equal(ctag_cbor_decode(ev[0].v.str.ptr, ev[0].v.str.len, c, 2u), 0);
		zassert_equal(c[0].v.u, 20u);
		zassert_true(c[1].present, "caps carry the bridge's own count");
		zassert_equal(c[1].v.u, 7u);
		zassert_equal(ctag_cbor_maps(&ev[1].v.str, none, 1u), 0, "the gateway holds none");
	}

	/* Two assignments on BRIDGE_A: the inventory nests them five levels deep. */
	for (uint32_t t = 1; t <= 2; t++) {
		zassert_equal(status_of(assign(CTAG_SERIAL_MSG_ASSIGN_TAG, 60u + t, BRIDGE_A, 0x500u + t,
					       t)),
			      CTAG_STATUS_ACCEPTED);
		end_last(0);
		mesh_assign_status(BRIDGE_A, 0x500u + t, t, CTAG_STATUS_OK);
	}
	host_read();
	rid = host_send(CTAG_SERIAL_MSG_GET_INVENTORY, NULL, 0u, 1u);
	host_read();
	zassert_equal(sent_count(CTAG_MESH_OP_CAPS_GET), 1u, "only configured bridges are asked");
	zassert_equal(last_sent(CTAG_MESH_OP_CAPS_GET)->dst, BRIDGE_A);
	f.key = CTAG_CBOR_KEY_ITEMS;
	decode(response(rid), &f, 1u);
	zassert_equal(ctag_cbor_maps(&f.v.str, items, 8u), 2);
	zassert_equal(ctag_cbor_decode(items[0].ptr, items[0].len, it, 6u), 0);
	zassert_equal(it[3].v.str.len, 6u);
	zassert_mem_equal(it[3].v.str.ptr, "1.2.13", 6u);
	zassert_equal(it[4].v.u, 8u << 20);
	zassert_true(it[5].present);
	{
		struct ctag_cbor_str as[4];
		struct ctag_cbor_field a[2] = {{.key = CTAG_CBOR_KEY_TAG_ID}, {.key = CTAG_CBOR_KEY_EPOCH}};

		zassert_equal(ctag_cbor_maps(&it[5].v.str, as, 4u), 2, "two assignments listed");
		zassert_equal(ctag_cbor_decode(as[1].ptr, as[1].len, a, 2u), 0);
		zassert_equal(a[0].v.u + a[1].v.u, 0x502u + 2u);
	}
	{
		/* The inventory's caps map carries the bridge's count too. */
		struct ctag_cbor_field cf = {.key = CTAG_CBOR_KEY_CAPS};
		struct ctag_cbor_field c = {.key = CTAG_CBOR_KEY_ASSIGNED_COUNT};

		zassert_equal(ctag_cbor_decode(items[0].ptr, items[0].len, &cf, 1u), 0);
		zassert_true(cf.present);
		zassert_equal(ctag_cbor_decode(cf.v.str.ptr, cf.v.str.len, &c, 1u), 0);
		zassert_true(c.present);
		zassert_equal(c.v.u, 7u, "the bridge's count, not the gateway's two");
	}
	zassert_equal(ctag_cbor_decode(items[1].ptr, items[1].len, it, 6u), 0);
	zassert_false(it[3].present, "no CAPS yet for the unconfigured bridge");
}
```
