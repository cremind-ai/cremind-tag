## CMakeLists.txt
```
cmake_minimum_required(VERSION 3.20.0)
find_package(Zephyr REQUIRED HINTS $ENV{ZEPHYR_BASE})
project(ctag_size)

target_sources(app PRIVATE src/tag.c)
target_sources_ifdef(CONFIG_CTAG_SIZE_BRIDGE app PRIVATE src/bridge.c)
```

## Kconfig
```
config CTAG_SIZE_BRIDGE
	bool "Also link the gateway/bridge libraries"
	select CTAG_FRAME
	select CTAG_CBOR
	select CTAG_RENDER

source "Kconfig.zephyr"
```

## prj.conf
```kconfig
# The tag-side libraries with the lean PSA profile (docs/firmware-notes.md 12).
CONFIG_CTAG_FRAG=y
CONFIG_CTAG_SESSION=y
CONFIG_CTAG_TXN=y
CONFIG_CTAG_ENROLL=y

CONFIG_PSA_CRYPTO=y
CONFIG_PSA_WANT_ALG_HMAC=y
CONFIG_PSA_WANT_ALG_SHA_256=y
CONFIG_PSA_WANT_ALG_CCM=y
CONFIG_PSA_WANT_KEY_TYPE_AES=y
CONFIG_PSA_WANT_KEY_TYPE_HMAC=y
CONFIG_PSA_WANT_GENERATE_RANDOM=n
CONFIG_MBEDTLS_PSA_KEY_SLOT_COUNT=2
CONFIG_ENTROPY_GENERATOR=y

CONFIG_ASSERT=n
CONFIG_LOG=n
CONFIG_STACK_USAGE=y
```

## src/bridge.c
```c
/* Calls the gateway/bridge library API (see tag.c). */
#include <ctag/ctag_cbor.h>
#include <ctag/ctag_crypto.h>
#include <ctag/ctag_fontpack.h>
#include <ctag/ctag_frame.h>
#include <ctag/ctag_render.h>
#include <ctag/ctag_session.h>

void size_bridge(void);

/* Small buffers: only the code size matters here (and the M0 has 16 KiB RAM). */
static uint8_t rx_buf[256];
static uint8_t tx_buf[256];
static uint8_t wire[CTAG_COBS_MAX_ENCODED(256u) + 1u];
static uint8_t layout[256];
static uint8_t strip[4 * 50];
static struct ctag_serial_rx serial;
static struct ctag_layout_asm assembler;
static struct ctag_fontpack pack;
static struct ctag_render_work work;
static struct ctag_render render;
static struct ctag_session session;
static ctag_sha256_ctx sha_ctx;

static int sha_init(void *ctx)
{
	return ctag_crypto_sha256_init(ctx);
}

static int sha_update(void *ctx, const uint8_t *data, size_t len)
{
	return ctag_crypto_sha256_update(ctx, data, len);
}

static int sha_finish(void *ctx, uint8_t digest[32])
{
	return ctag_crypto_sha256_finish(ctx, digest);
}

static int flash_read(void *ctx, uint32_t offset, void *buf, size_t len)
{
	(void)ctx;
	(void)offset;
	(void)buf;
	(void)len;
	return 0;
}

void size_bridge(void)
{
	const struct ctag_sha256_ops sha = {sha_init, sha_update, sha_finish, &sha_ctx};
	struct ctag_render_panel panel = {400, 300, 2, 3};
	struct ctag_cbor_field fields[4] = {{.key = CTAG_CBOR_KEY_STATUS}};
	struct ctag_cbor_counter counters[4];
	struct ctag_cbor_str items[4];
	struct ctag_serial_header hdr;
	struct ctag_mesh_layout_begin begin = {0};
	struct ctag_mesh_layout_chunk chunk = {0};
	struct ctag_glyph_source src;
	struct ctag_ctrl_challenge ch;
	uint8_t digest[32];
	uint32_t missing;
	int n;

	ctag_serial_rx_init(&serial, rx_buf, sizeof(rx_buf));
	if (ctag_serial_rx_put(&serial, wire[0], &hdr) &&
	    ctag_cbor_decode(&rx_buf[CTAG_SERIAL_HEADER_LEN], hdr.length, fields, 4) == 0) {
		(void)ctag_cbor_maps(&fields[0].v.str, items, 4);
		(void)ctag_cbor_counters(&fields[0].v.str, counters, 4);
	}
	n = ctag_cbor_encode(fields, 1, &tx_buf[CTAG_SERIAL_HEADER_LEN],
			     sizeof(tx_buf) - CTAG_SERIAL_MIN_FRAME);
	n = ctag_serial_frame_build(tx_buf, sizeof(tx_buf), &hdr, NULL, (size_t)n);
	(void)ctag_serial_wire_encode(tx_buf, (size_t)n, wire, sizeof(wire));
	(void)ctag_cobs_decode(wire, sizeof(wire), tx_buf, sizeof(tx_buf));

	ctag_layout_asm_init(&assembler, layout, sizeof(layout));
	ctag_layout_asm_begin(&assembler, &begin);
	(void)ctag_layout_asm_chunk(&assembler, &chunk);
	(void)ctag_layout_asm_commit(&assembler, 0, &missing, &sha);
	if (ctag_fontpack_open(&pack, flash_read, NULL, 1u << 24) == CTAG_STATUS_OK) {
		(void)ctag_fontpack_verify_content(&pack, &sha, strip, sizeof(strip));
	}
	ctag_fontpack_glyph_source(&pack, &src);
	if (ctag_render_init(&render, layout, begin.total_len, &panel, &src, &work) ==
	    CTAG_STATUS_OK) {
		(void)ctag_render_frame_digest(&render, strip, sizeof(strip), &sha, digest);
		(void)ctag_render_strip(&render, 0, 0, 4, strip, sizeof(strip));
	}

	(void)ctag_session_bridge_hello(&session, 1, 1, digest, digest, tx_buf);
	(void)ctag_session_bridge_challenge(&session, rx_buf, 18, rx_buf, 30, &ch, tx_buf);
	(void)ctag_session_bridge_auth_ok(&session, rx_buf, 17);
}
```

## src/tag.c
```c
/*
 * Calls the library API a tag uses (and, with CONFIG_CTAG_SIZE_BRIDGE, the
 * gateway/bridge API in bridge.c) so the link keeps exactly that code. Never
 * run; built to measure the footprint.
 */
#include <errno.h>

#include <ctag/ctag_crypto.h>
#include <ctag/ctag_enroll.h>
#include <ctag/ctag_frag.h>
#include <ctag/ctag_session.h>
#include <ctag/ctag_txn.h>

void size_bridge(void);

static uint8_t rec_buf[2][CTAG_TAG_RECORD_BUF];
static uint8_t ctrl_buf[CTAG_TAG_CTRL_MSG_MAX];
static uint8_t value[CTAG_ATT_VALUE_MAX];
static uint8_t pt[CTAG_TAG_RECORD_PAYLOAD_MAX];
static uint8_t uicr[CTAG_ENROLLMENT_LEN];
static struct ctag_session session;
static struct ctag_txn_record record;
static ctag_sha256_ctx digest;

static int nvs_read(void *ctx, void *buf, size_t len)
{
	(void)ctx;
	(void)buf;
	(void)len;
	return -ENOENT;
}

static int nvs_write(void *ctx, const void *buf, size_t len)
{
	(void)ctx;
	(void)buf;
	return (int)len;
}

int main(void)
{
	struct ctag_txn_store store = {nvs_read, nvs_write, NULL};
	struct ctag_enrollment enroll;
	struct ctag_ctrl_challenge ch = {0};
	struct ctag_rec_frame_begin fb = {0};
	struct ctag_rec_result res;
	struct ctag_frag_rx rx;
	struct ctag_frag_tx tx;
	size_t off = 0;
	size_t len;
	uint8_t type;
	int n;

	(void)ctag_crypto_init();
	(void)ctag_enroll_parse(uicr, sizeof(uicr), &enroll);
	(void)ctag_crypto_random(ch.nonce_t, sizeof(ch.nonce_t));
	ctag_frag_rx_init(&rx, ctrl_buf, sizeof(ctrl_buf));
	ctag_frag_tx_init(&tx);
	n = ctag_frag_rx_put(&rx, value, sizeof(value));
	(void)ctag_session_tag_hello(&session, enroll.tag_id, enroll.secret, value, sizeof(value), &ch,
				     ctrl_buf, (size_t)n, rec_buf[0], &len);
	(void)ctag_session_tag_auth(&session, ch.stored_epoch, ctrl_buf, (size_t)n, rec_buf[0], &len);
	(void)ctag_frag_next(&tx, rec_buf[0], len, &off, CTAG_FRAG_PAYLOAD_MAX, value);
	n = ctag_record_open(&session.rx, rec_buf[1], sizeof(rec_buf[1]), &type, pt, sizeof(pt));
	/* The incremental digest of the plane bytes (5.6). */
	if (ctag_crypto_sha256_init(&digest) != 0 ||
	    ctag_crypto_sha256_update(&digest, pt, (size_t)n) != 0 ||
	    ctag_crypto_sha256_finish(&digest, fb.digest) != 0) {
		ctag_crypto_sha256_abort(&digest);
	}
	(void)ctag_txn_load(&store, &record);
	(void)ctag_txn_boot(&record);
	if (ctag_txn_frame_begin(&record, session.epoch, &fb, 1, 15000) == CTAG_TXN_ACCEPT) {
		ctag_txn_intent(&record, enroll.tag_id, session.epoch, fb.revision, fb.update_id,
				fb.digest);
		ctag_txn_complete(&record, CTAG_STATUS_OK);
		(void)ctag_txn_save(&store, &record);
	}
	ctag_txn_result(&record, 0, &res);
	(void)ctag_rec_result_pack(&res, pt, sizeof(pt));
	n = ctag_record_seal(&session.tx, CTAG_REC_RESULT, pt, CTAG_REC_RESULT_LEN, rec_buf[0],
			     sizeof(rec_buf[0]));
	(void)ctag_txn_unknown_pending(&record);
#ifdef CONFIG_CTAG_SIZE_BRIDGE
	size_bridge();
#endif
	return n;
}
```
