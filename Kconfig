## apps/bridge/tests/core/testcase.yaml
```yaml
common:
  tags:
    - ctag
    - bridge
  platform_allow:
    - native_sim
    - native_sim/native/64
  integration_platforms:
    - native_sim
tests:
  ctag.bridge.core: {}
  # The shared core with the nRF52832 bridge's sizes (socs/nrf52832.conf).
  ctag.bridge.core.nrf52832:
    extra_configs:
      - CONFIG_CTAG_BRIDGE_MAX_TAGS=10
      - CONFIG_CTAG_BRIDGE_SESSIONS=1
      - CONFIG_CTAG_BRIDGE_MAX_JOBS=16
      - CONFIG_CTAG_BRIDGE_RESULT_SLOTS=8
      - CONFIG_CTAG_BRIDGE_STRIP_BUF=800
      - CONFIG_CTAG_RENDER_QR_SLOTS=1
      - CONFIG_CTAG_BRIDGE_READ_CACHE_LINES=8
      - CONFIG_CTAG_BRIDGE_READ_CACHE_LINE=64
      - CONFIG_CTAG_BRIDGE_MAINT_MAX_FRAME=512
      - CONFIG_CTAG_BRIDGE_MAINT_TX_FRAME=1280
      - CONFIG_CTAG_BRIDGE_MAINT_CREDITS=1
```

## boards/cremind/hema_52811/Kconfig.hema_52811
```kconfig
# Copyright (c) 2026 Cremind
# SPDX-License-Identifier: MIT

config BOARD_HEMA_52811
	select SOC_NRF52811_QFAA
```

## boards/cremind/hema_52811/board.yml
```yaml
board:
  name: hema_52811
  full_name: Hema/Alibaba nRF52811 e-paper tag
  vendor: cremind
  socs:
    - name: nrf52811
```

## boards/cremind/laowu_bw/Kconfig.laowu_bw
```kconfig
# Copyright (c) 2026 Cremind
# SPDX-License-Identifier: MIT

config BOARD_LAOWU_BW
	select SOC_NRF51822_QFAB
```

## boards/cremind/laowu_bw/board.yml
```yaml
board:
  name: laowu_bw
  full_name: Laowu 4.2-inch black/white e-paper tag
  vendor: cremind
  socs:
    - name: nrf51822
```

## boards/cremind/laowu_bwr/board.yml
```yaml
board:
  name: laowu_bwr
  full_name: Laowu 4.2-inch black/white/red e-paper tag
  vendor: cremind
  socs:
    - name: nrf51822
```

## boards/cremind/sifei_52810/Kconfig.sifei_52810
```kconfig
# Copyright (c) 2026 Cremind
# SPDX-License-Identifier: MIT

config BOARD_SIFEI_52810
	select SOC_NRF52810_QFAA
```

## boards/cremind/sifei_52810/board.yml
```yaml
board:
  name: sifei_52810
  full_name: Sifei nRF52810 e-paper tag
  vendor: cremind
  socs:
    - name: nrf52810
```

## dts/bindings/cremind,ssd1619.yaml
```yaml
# Copyright (c) 2026 Cremind
# SPDX-License-Identifier: MIT

title: Solomon Systech SSD1619 e-paper panel driven by the Cremind Tag firmware

description: |
  A Solomon Systech SSD1619 e-paper controller on a Cremind tag board. The panel
  is driven by the Cremind Tag panel library (not the Zephyr display API):
  writes stage image planes into controller RAM and only an explicit commit
  refreshes (docs/protocol.md section 6). The properties shared with
  cremind,uc8176 keep their names and meaning, so the firmware reads the
  chosen panel the same way whatever its controller.

  Panel identity and safety contract: as for cremind,uc8176 (panel-id 255 is
  never driven; panel-verified only after a check on a physical sample).

  BUSY: describe busy-gpios with GPIO_ACTIVE_HIGH (plus any pull flag). The
  firmware reads the raw pin level and interprets it with busy-active-high.
  The SSD1619 BUSY output is high while the controller is busy, so
  busy-active-high is normally present.

compatible: "cremind,ssd1619"

include: [spi-device.yaml]

properties:
  dc-gpios:
    type: phandle-array
    required: true
    description: Data/command select. Physical high selects data.

  reset-gpios:
    type: phandle-array
    required: true
    description: Controller reset (RES#, active low).

  busy-gpios:
    type: phandle-array
    required: true
    description: |
      Controller BUSY output, read as a raw level; see busy-active-high.

  bs-gpios:
    type: phandle-array
    description: |
      Optional bus-select (BS1) line routed to the MCU. The firmware drives it
      physically low to select the 4-wire SPI interface before reset.

  en-gpios:
    type: phandle-array
    description: |
      Optional panel supply switch routed to the MCU. The firmware drives it
      active once at boot, before any other panel pin, and keeps the panel
      powered: between refreshes the controller is in deep sleep.

  width:
    type: int
    required: true
    description: Native panel width in pixels (source direction, multiple of 8).

  height:
    type: int
    required: true
    description: Native panel height in pixels (gate direction).

  ram-x-offset:
    type: int
    default: 0
    description: |
      First RAM column of the panel in pixels (multiple of 8): some panels
      start their visible area a byte into the controller RAM.

  planes:
    type: int
    required: true
    enum: [1, 2]
    description: Image planes; 1 = black/white, 2 = black/white + red.

  plane-flags:
    type: int
    default: 0
    description: |
      Bit meaning of the planes as reported in CAPS (protocol/spec.yaml
      tag_caps.plane_flags): bit0 set = a 1 bit in plane 0 is white;
      bit1 set = a 1 bit in plane 1 is red.

  busy-active-high:
    type: boolean
    description: A high BUSY level means busy (SSD1619). Absent = low means busy.

  refresh-timeout-ms:
    type: int
    required: true
    description: |
      Upper bound for BUSY to release after a refresh command. Exceeding it
      yields REFRESH_TIMEOUT.

  panel-id:
    type: int
    required: true
    description: Protocol panel id (protocol/spec.yaml `panels`); 255 = UNVERIFIED.

  panel-verified:
    type: boolean
    description: Pins, polarity, panel model and planes verified on hardware.
```

## dts/bindings/cremind,tag-board.yaml
```yaml
# Copyright (c) 2026 Cremind
# SPDX-License-Identifier: MIT

title: Cremind Tag board identity and verified hardware features

description: |
  One node per Cremind tag board (usually chosen as `cremind,tag-board`). It
  carries the protocol board id reported in CAPS and in the enrollment blob,
  and records which optional hardware features have been physically verified
  (docs/hardware/verification.md). Firmware must treat every feature that is
  not marked verified as absent.

compatible: "cremind,tag-board"

properties:
  board-id:
    type: int
    required: true
    description: Protocol board id (protocol/spec.yaml `boards`).

  wake-gpios:
    type: phandle-array
    description: |
      External wake input (button, reed switch or NFC field detect, as
      documented for the board). Only usable when wake-verified is present.

  wake-verified:
    type: boolean
    description: |
      The wake input, its polarity and its ability to leave System OFF were
      verified on hardware. CMD{SLEEP} (System OFF) is refused without it.

  hfxo-verified:
    type: boolean
    description: The high-frequency crystal frequency was verified on hardware.

  lfxo-verified:
    type: boolean
    description: |
      A 32.768 kHz crystal was verified on hardware. Until then the board
      defconfig selects the calibrated RC oscillator.

  dcdc-verified:
    type: boolean
    description: |
      The DC/DC inductor was verified on hardware; only then may firmware
      enable the DC/DC regulator (docs/firmware-notes.md section 6).
```

## dts/bindings/cremind,uc8176.yaml
```yaml
# Copyright (c) 2026 Cremind
# SPDX-License-Identifier: MIT

title: UltraChip UC8176 e-paper panel driven by the Cremind Tag firmware

description: |
  An UltraChip UC8176 e-paper controller on a Cremind tag board. The panel is
  driven by the Cremind Tag panel library (not the Zephyr display API): writes
  stage image planes into controller RAM and only an explicit commit refreshes
  (docs/protocol.md section 6).

  Panel identity and safety contract:

  - panel-id is the protocol panel id (protocol/spec.yaml `panels`), reported in
    the tag CAPS. panel-id 255 (UNVERIFIED) marks placeholder pins: the firmware
    must never initialise the SPI bus nor configure or drive any panel pin, and
    it must refuse every frame. Boards with placeholder pins also mark their SPI
    bus `zephyr,deferred-init` so that no driver touches those pins at boot.
  - panel-verified is set only after the pin mapping, polarity, panel model and
    planes were checked on a physical sample (docs/hardware/verification.md).
    A board with a real panel-id but panel-verified absent carries documented
    but not yet physically verified pins; it may be driven for bring-up.

  BUSY: describe busy-gpios with GPIO_ACTIVE_HIGH (plus any pull flag). The
  firmware reads the raw pin level and interprets it with busy-active-high, so
  polarity is expressed in exactly one place. The UC8176 BUSY_N output is low
  while the controller is busy, so busy-active-high is normally absent.

compatible: "cremind,uc8176"

include: [spi-device.yaml]

properties:
  dc-gpios:
    type: phandle-array
    required: true
    description: Data/command select. Physical high selects data.

  reset-gpios:
    type: phandle-array
    required: true
    description: Controller reset (RST_N, active low).

  busy-gpios:
    type: phandle-array
    required: true
    description: |
      Controller BUSY output, read as a raw level; see busy-active-high.

  bs-gpios:
    type: phandle-array
    description: |
      Optional bus-select (BS1) line routed to the MCU. The firmware drives it
      physically low to select the 4-wire SPI interface before reset.

  width:
    type: int
    required: true
    description: Native panel width in pixels (source direction).

  height:
    type: int
    required: true
    description: Native panel height in pixels (gate direction).

  planes:
    type: int
    required: true
    enum: [1, 2]
    description: Image planes; 1 = black/white, 2 = black/white + red.

  plane-flags:
    type: int
    default: 0
    description: |
      Bit meaning of the planes as reported in CAPS (protocol/spec.yaml
      tag_caps.plane_flags): bit0 set = a 1 bit in plane 0 is white;
      bit1 set = a 1 bit in plane 1 is red.

  busy-active-high:
    type: boolean
    description: A high BUSY level means busy. Absent = low means busy (UC8176).

  refresh-timeout-ms:
    type: int
    required: true
    description: |
      Upper bound for BUSY to release after a refresh command. Exceeding it
      yields REFRESH_TIMEOUT.

  panel-id:
    type: int
    required: true
    description: Protocol panel id (protocol/spec.yaml `panels`); 255 = UNVERIFIED.

  panel-verified:
    type: boolean
    description: Pins, polarity, panel model and planes verified on hardware.
```

## lib/Kconfig
```kconfig
# Cremind Tag firmware libraries (docs/firmware-libs.md). Applications enable
# only the libraries they link.

config CTAG_FRAME
	bool "Serial framing: COBS, CRC-32 frames, credits"
	select CTAG_CRC32
	help
	  COBS stream decoder, serial frame build/check (docs/protocol.md 1.1)
	  and credit accounting (1.3). Gateway and bridge maintenance port.

config CTAG_CBOR
	bool "Serial CBOR payload maps (zcbor)"
	select ZCBOR
	select ZCBOR_CANONICAL
	select CTAG_UTF8
	help
	  Canonical encode / strict decode of the integer-keyed CBOR maps carried
	  by serial frames. Gateway and bridge maintenance port.

config CTAG_LAYOUT
	bool "Layout validator, iterator and chunk assembler"
	help
	  Validation in the order of docs/protocol.md 4.3, the command iterator
	  and the LAYOUT_BEGIN/CHUNK/COMMIT assembler of 3.2-3.3. Bridge.

config CTAG_RENDER
	bool "Strip renderer, font-pack reader, QR"
	select CTAG_LAYOUT
	select CTAG_CRC32
	select CTAG_UTF8
	help
	  Bit-exact strip renderer (docs/protocol.md 4.4), font-pack reader
	  (docs/fontpack.md) and the vendored Nayuki qrcodegen v1.8.0. Bridge.

config CTAG_RENDER_QR_SLOTS
	int "QR symbols the renderer keeps across the strips of a frame"
	depends on CTAG_RENDER
	default 4
	range 1 4
	help
	  408 bytes of ctag_render_work each. With one per QR command
	  (docs/protocol.md 4.3 allows LAYOUT_MAX_QR = 4) every symbol is
	  encoded once per frame; with fewer the commands beyond the slots
	  share the last one and are re-encoded, with their remembered mask,
	  for every strip they reach.

config CTAG_FRAG
	bool "GATT fragmentation"
	help
	  Fragment encoder and reassembler of docs/protocol.md 5.3. Tag,
	  bridge and the gateway's own radio.

config CTAG_SCHED
	bool "Tag connection scheduler (the mesh suspend window)"
	help
	  The connection scheduler of docs/protocol.md 5.2: one connection
	  attempt at a time, each in its own mesh suspend window, the
	  rolling-minute rate limit, the per-tag back-off with its one quick
	  retry, and up to CTAG_SCHED_LINKS tag connections at once. Pure
	  logic: Bluetooth goes through struct sched_ops. Bridge and the
	  gateway's own radio (docs/protocol.md 11).

config CTAG_SCHED_LINKS
	int "Tag connections the scheduler holds at once"
	depends on CTAG_SCHED
	default 1
	range 1 4
	help
	  One struct sched_link each. The application sets it to its own
	  count (bridge: CTAG_BRIDGE_SESSIONS, gateway: CTAG_GW_TAG_LINKS)
	  and asserts that they match.

config CTAG_SCHED_TAGS
	int "Per-tag back-off entries"
	depends on CTAG_SCHED
	default 20
	range 1 64
	help
	  Tags whose last failure the scheduler remembers (12 bytes each);
	  when full, the entry expiring first is reused. The bridge keeps
	  one per assignable tag (CTAG_BRIDGE_MAX_TAGS).

config CTAG_SESSION
	bool "Tag session handshake and records"
	depends on PSA_CRYPTO
	select CTAG_CRYPTO_PSA
	help
	  Handshake state machines for the bridge and the tag, and record
	  seal/open (docs/protocol.md 5.4-5.5), over ctag_crypto.h with the PSA
	  backend. The lean PSA profile of docs/firmware-notes.md 12 suffices:
	  PSA_WANT_ALG_HMAC, PSA_WANT_ALG_SHA_256, PSA_WANT_ALG_CCM,
	  PSA_WANT_KEY_TYPE_AES, PSA_WANT_AES_KEY_SIZE_128,
	  PSA_WANT_KEY_TYPE_HMAC; nonces come from sys_csrand_get().

config CTAG_CRYPTO_PSA
	bool
	depends on PSA_CRYPTO

config CTAG_SECURE
	bool "Protocol v2 secure layer (Noise* IK, HACL*)"
	select CTAG_CRC32
	help
	  Device identity, the v2 key schedule, canonical grants and the
	  device-side grant rules, the ownership record, secure-message
	  framing, tunnel fragments and the responder-side secure endpoint
	  of docs/connect-setup.md, on the vendored Noise*
	  (Noise_IK_25519_ChaChaPoly_SHA256) and HACL* (X25519, Ed25519,
	  ChaCha20-Poly1305, SHA-256, HMAC) of lib/third_party. Gateway,
	  bridge and tag.

config CTAG_SECURE_HEAP_SIZE
	int "Secure heap for Noise* (bytes)"
	depends on CTAG_SECURE
	default 12288
	help
	  Noise* allocates its device, peer and session objects and a copy of
	  every message it seals or opens (KaRaMeL's KRML_HOST_MALLOC). They
	  live in this fixed sys_heap; a failed allocation fails the session,
	  never the device. Peak use is about 1.2 KiB for a session plus twice
	  the largest message sealed or opened at once (docs/firmware-libs.md).

config CTAG_TXN
	bool "Tag display transaction"
	select CTAG_CRC32
	help
	  FRAME_BEGIN decision table, boot recovery rule and the persisted
	  display record (docs/protocol.md 5.6, 6). Tag.

config CTAG_ENROLL
	bool "Enrollment blob parser"
	select CTAG_CRC32
	help
	  Parse and verify the 48-byte UICR enrollment blob (docs/protocol.md
	  9). Tag.

config CTAG_CRC32
	bool

choice CTAG_CRC32_IMPL
	prompt "CRC-32 implementation"
	depends on CTAG_CRC32
	default CTAG_CRC32_NIBBLE if CTAG_FRAME || CTAG_RENDER
	default CTAG_CRC32_BITWISE

config CTAG_CRC32_BITWISE
	bool "Bitwise, no table"
	help
	  Smallest; enough for the tag's enrollment blob and display record.

config CTAG_CRC32_NIBBLE
	bool "16-entry table"
	help
	  About four times faster than bitwise for 64 more bytes of flash:
	  font-pack index checks and serial frames.

config CTAG_CRC32_ZEPHYR
	bool "Zephyr's crc32_ieee_update()"
	select CRC
	help
	  Share Zephyr's CRC-32 when the application links crc32_ieee()
	  anyway.

endchoice

config CTAG_UTF8
	bool
```

## tests/ztest/cbor/testcase.yaml
```yaml
common:
  tags:
    - ctag
  platform_allow:
    - native_sim
    - native_sim/native/64
  integration_platforms:
    - native_sim
tests:
  ctag.cbor: {}
```
